## modules/quicklz/Kconfig
```kconfig
config QUICKLZ
    bool "QuickLZ 1.5 level-3 decoder"
    help
      Decode bounded QuickLZ 1.5 level-3 blocks without streaming history.
      Supports compressed and stored blocks using caller-provided buffers.
      The decoder has no allocation, kernel, storage or crypto dependencies.
```

## modules/transmit/Kconfig
```kconfig
menuconfig TRANSMIT
    bool "Equipment mapping and protocol forwarding"
    depends on DATAPROCESS && MODBUS_SERVER
    default y

if TRANSMIT

config HEAP_MEM_POOL_ADD_SIZE_TRANSMIT
    int "Shared heap budget for forwarding message buffers (bytes)"
    default 4096
    range 512 65536
    help
      Covers simultaneous RAW receive ADUs, transmit frames and register
      conversion buffers. Tune for forwarding concurrency and payload size.

config TR_VPORT
    bool "Complete-message ports through vport"
    select VPORT

rsource "protocols/modbus/Kconfig"

endif
```

## modules/transmit/protocols/modbus/Kconfig
```kconfig
config TR_CONN_TIMEOUT_MS
    int "Accepted Modbus request inactivity timeout (ms)"
    default 5000
    range 10 3600000

config TR_MODBUS_ADAPTER
    bool "Whole-PDU Modbus routing and isolated forwarding workers"
    default y if DP_PARAMS
    help
      Enable the reviewed build-local Zephyr Modbus adapter for complete-request
      routing and isolated workers. This is also available without NVS storage.

config TR_STACK_SIZE
    int "Stack size per isolated forwarding port (bytes)"
    default 4096
    range 1024 65536
    depends on TR_MODBUS_ADAPTER
    help
      Stack size for each isolated forwarding worker, including protocol and
      write callbacks. The application supplies queues/stacks for its actual
      contexts; transmit does not create workers or allocate their stacks.

config TR_PORTS
    int "Maximum forwarding entries / isolated workqueues"
    default 1
    range 1 4
    help
      Maximum immutable forwarding mapping bindings. When TR_MODBUS_ADAPTER
      is enabled, also reserves this many isolated forwarding states.
      Stacks are supplied by the application. This is separate from the number of
      interfaces bound to the Modbus virtual-port transport.

config TR_CONFIG_STACK_SIZE
    int "Shared forwarding reconfiguration stack size (bytes)"
    default 2048
    range 1024 65536
    depends on TR_MODBUS_ADAPTER
    help
      Suggested stack size for the application-supplied control worker handling
      port reconfiguration and recovery. Transmit does not allocate this stack.

config TR_SERVER_SERVICE
    bool "Configured forwarding server lifecycle"
    depends on TR_MODBUS_ADAPTER

config TR_REGISTER_SERVICE
    bool "Configured protocol segments and standard address routes"
    depends on TR_MODBUS_ADAPTER


config TR_MODBUS_RAW_PORT
    bool "Modbus RAW complete-message port adapter"
    depends on TR_MODBUS_ADAPTER && MODBUS_RAW_ADU
    depends on !MODBUS_SERIAL_ASYNC_API
    select TR_VPORT

config TR_MODBUS_TX_TIMEOUT_MS
    int "Complete-message send timeout (ms)"
    depends on TR_MODBUS_RAW_PORT
    default 3000
    range 10 10000

config TR_FORWARD_CONFIG
    bool "Independent forwarding device declarations"
    depends on DP_TABLE_REGISTRY && TR_REGISTER_SERVICE && TR_SERVER_SERVICE
    help
      Resolve each forwarding entry's own const mapping and protocol segments.
      Data identities and parameter records remain owned by DP.
```

## modules/vport/Kconfig
```kconfig
menuconfig VPORT
    bool "Generic callback communication ports"
    depends on MULTITHREADING
    help
      Shared by collect and transmit. Does not own hardware, protocol framing,
      routing tables, receive buffers or worker threads.

if VPORT
config VPORT_MAX_PORTS
    int "Maximum registered logical ports"
    default 8
    range 1 64
endif
```

## modules/watchdog/Kconfig
```kconfig
config WATCHDOG_SOFTWARE
    bool "Software task watchdog"
    help
      Monitor explicitly registered task heartbeat deadlines independently
      of the external watchdog. Report timeouts through a caller callback.

config WATCHDOG_EXTERNAL
    bool "External GPIO watchdog"
    depends on GPIO
    help
      Initialize the app,gpio-watchdog devicetree GPIO when the application
      explicitly calls watchdog_init(), then periodically toggle it.
      When disabled,
      leave the GPIO untouched and do not start the feed timer.

config WATCHDOG_CHECK_INTERVAL_MS
    int "Task watchdog check interval in milliseconds"
    depends on WATCHDOG_SOFTWARE
    default 100
    range 1 60000
    help
      Run task checks on the system workqueue at this interval. Only completed,
      successful checks renew health. Results and startup grace remain valid
      for exactly three times this interval.
```

## modules/watchdog/dts/bindings/watchdog/app,gpio-watchdog.yaml
```yaml
description: Periodic GPIO edge feeding for an external watchdog
compatible: "app,gpio-watchdog"
include: base.yaml
properties:
  feed-gpios:
    type: phandle-array
    required: true
    description: On-chip GPIO supporting interrupt-safe toggling
  feed-interval-ms:
    type: int
    required: true
    description: Positive interval between feed edges in milliseconds
```

## soc/idu/gd32e505/Kconfig.soc
```kconfig
config SOC_GD32E505
    bool
    select SOC_SERIES_GD32E50X

config SOC
    default "gd32e505" if SOC_GD32E505
```

## src/iap/Kconfig
```kconfig
config IDU_IAPV3
    bool "MV-IO IAPv3 AES/SGZ receiver"
    depends on BOOTLOADER_MCUBOOT && !IDU_AIDC_PROFILE && !MCUMGR_GRP_IMG
    depends on IMG_MANAGER && MCUBOOT_IMG_MANAGER && IMG_ERASE_PROGRESSIVELY
    depends on STREAM_FLASH && FLASH_MAP && FLASH_PAGE_LAYOUT && NVS && REBOOT
    select QUICKLZ
    help
      Alternative to SMP image upload on the fitted MV-IO RS485 port.
      Accepts a single ARM QuickLZ level-3 SGZ containing a signed MCUboot
      ECDSA-P256 image. Delta and downstream-device upgrades are unsupported.
```

## tests/acquisition/testcase.yaml
```yaml
tests:
  idu.acquisition.lifecycle:
    platform_allow: native_sim/native/64
    # 运行验收使用 run.py，在各独立进程中隔离单例。
    build_only: true
    tags: [idu, acquisition]
```

## tests/boot/testcase.yaml
```yaml
tests:
  idu.boot.confirmation:
    platform_allow: native_sim/native/64
    tags: [idu, mcuboot]
```

## tests/collect_modbus/testcase.yaml
```yaml
tests:
  idu.collect.modbus_client_only:
    platform_allow: native_sim/native/64
    tags:
      - modbus
      - collect
```

## tests/collect_state/testcase.yaml
```yaml
tests:
  idu.collect_state:
    platform_allow: native_sim/native/64
    tags: collect protocol
```

## tests/collector/testcase.yaml
```yaml
tests:
  idu.collector.scheduling:
    platform_allow: native_sim/native/64
    integration_platforms:
      - native_sim/native/64
    tags:
      - modbus
      - zbus
      - idu
  idu.collector.callback_backend:
    platform_allow: native_sim/native/64
    extra_args: EXTRA_CONF_FILE=adapter-off.conf
    tags:
      - modbus
      - zbus
      - idu
```

## tests/communication/testcase.yaml
```yaml
tests:
  idu.communication:
    platform_allow: native_sim/native/64
    tags: modbus vport
```

## tests/dataprocess/Kconfig
```kconfig
mainmenu "Standalone dataprocess tests"
source "Kconfig.zephyr"

config DP_TEST_TRANSPORT
    bool "Inject a test parameter transport"
    depends on DP_PARAMS
```

## tests/dataprocess/testcase.yaml
```yaml
tests:
  dataprocess.standalone.telemetry:
    platform_allow: native_sim/native/64
    integration_platforms:
      - native_sim/native/64
    tags: [zbus, dataprocess]
  dataprocess.standalone.local_params:
    platform_allow: native_sim/native/64
    integration_platforms:
      - native_sim/native/64
    extra_args: EXTRA_CONF_FILE=params.conf
    tags: [nvs, dataprocess]
  dataprocess.standalone.injected_transport:
    platform_allow: native_sim/native/64
    integration_platforms:
      - native_sim/native/64
    extra_args: EXTRA_CONF_FILE=transport.conf
    tags: [nvs, dataprocess]
```

## tests/fixtures/Kconfig
```kconfig
config IDU_TEST_FIXTURES
    bool
    default y
    depends on ZTEST
    select CO_SIMULATOR
```

## tests/iap/testcase.yaml
```yaml
tests:
  idu.iap.receiver:
    platform_allow: native_sim/native/64
    integration_platforms:
      - native_sim/native/64
    tags:
      - modbus
      - nvs
      - mcuboot
  idu.iap.configured:
    platform_allow: native_sim/native/64
    integration_platforms:
      - native_sim/native/64
    extra_args:
      - EXTRA_CONF_FILE=configured.conf
      - EXTRA_DTC_OVERLAY_FILE=configured.overlay
    tags:
      - modbus
      - nvs
      - mcuboot
```

## tests/image_confirm/testcase.yaml
```yaml
tests:
  idu.image.confirmation:
    platform_allow: native_sim/native/64
    tags: [idu, mcuboot]
```

## tests/io/testcase.yaml
```yaml
tests:
  modules.io:
    platform_allow: native_sim/native/64
    tags: [gpio, watchdog]
```

## tests/modbus_support/testcase.yaml
```yaml
tests:
  modbus_support.rtu:
    platform_allow: native_sim/native/64
    tags: modbus
```

## tests/mvio/testcase.yaml
```yaml
tests:
  idu.mvio.compatibility:
    platform_allow: native_sim/native/64
    integration_platforms:
      - native_sim/native/64
    tags:
      - modbus
      - nvs
      - idu
```

## tests/parameter_records/testcase.yaml
```yaml
tests:
  idu.parameter_records:
    platform_allow: native_sim/native/64
    tags: storage dataprocess
```
