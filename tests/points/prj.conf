## CMakeLists.txt
```
cmake_minimum_required(VERSION 3.20.0)
get_filename_component(IDU_APP ${CMAKE_CURRENT_SOURCE_DIR}/../.. ABSOLUTE)
include(${IDU_APP}/modules/modules.cmake)
set(DTC_OVERLAY_FILE ${CMAKE_CURRENT_SOURCE_DIR}/app.overlay)
find_package(Zephyr REQUIRED HINTS $ENV{ZEPHYR_BASE})
project(idu_points_tests)
target_include_directories(app PRIVATE ${IDU_APP}/app ${IDU_APP}/tests)
target_sources(app PRIVATE src/main.c)
add_subdirectory(${IDU_APP}/app/protocol app_cfg)
add_subdirectory(${IDU_APP}/app/process point_process)

target_sources(app PRIVATE src/parameters.c)
target_sources(app PRIVATE src/storage_fault.c)

target_sources(app PRIVATE src/modules.c)

# 注入一次后端初始化失败，验证串行回滚。
zephyr_ld_options(-Wl,--wrap=modbus_init_server)
# 仅在外部 NVS 接口的指定步骤注入参数故障。
zephyr_ld_options(-Wl,--wrap=nvs_mount -Wl,--wrap=nvs_write -Wl,--wrap=nvs_delete)

add_subdirectory(${IDU_APP}/tests/fixtures fixtures)
```

## Kconfig
```
mainmenu "IDU point table tests"
source "Kconfig.zephyr"
rsource "../../app/Kconfig"

rsource "../fixtures/Kconfig"
```

## prj.conf
```kconfig
CONFIG_ZTEST=y
CONFIG_MODBUS=y
CONFIG_MODBUS_ROLE_CLIENT_SERVER=y
CONFIG_MODBUS_FP_EXTENSIONS=n
CONFIG_MODBUS_RAW_ADU=y
CONFIG_MODBUS_NUMOF_RAW_ADU=4
CONFIG_DATAPROCESS=y
CONFIG_CO_MAX_BUSES=2
CONFIG_ZBUS_PREFER_DYNAMIC_ALLOCATION=n
CONFIG_ZBUS_MSG_SUBSCRIBER_BUF_ALLOC_STATIC=y
CONFIG_ZBUS_MSG_SUBSCRIBER_NET_BUF_POOL_SIZE=2
CONFIG_ZBUS_MSG_SUBSCRIBER_NET_BUF_STATIC_DATA_SIZE=640
CONFIG_MAIN_STACK_SIZE=4096
CONFIG_TEST_EXTRA_STACK_SIZE=4096
CONFIG_SYSTEM_WORKQUEUE_STACK_SIZE=2048
CONFIG_NATIVE_SIM_SLOWDOWN_TO_REAL_TIME=n

CONFIG_DP_PARAMS=y
CONFIG_FLASH=y
CONFIG_FLASH_MAP=y
CONFIG_FLASH_PAGE_LAYOUT=y
CONFIG_FLASH_SIMULATOR_CALLBACKS=y
```

## src/main.c
```c
#include "../../fixtures/tr_tasks.h"
#include "../../fixtures/dp_tasks.h"
#include "../../fixtures/point_connections.h"
#include <transmit/server.h>
#include "simulation.h"
#include "protocol/inc/protocol.h"
#include <collect/port.h>
#include <collect/simulator.h>
#include <transmit/registers.h>
#include <platform_callback.h>
#include "process/points.h"
#include "protocol/inc/signal_ids.h"
#include "../../fixtures/local_sample.h"
#include <collect/collect.h>
#include <dataprocess/params.h>
#include <dataprocess/points.h>
#include <dataprocess/process.h>
#include <transmit/modbus_adapter.h>
#include <transmit/transmit.h>
#include <transmit/forward.h>
#include <dataprocess/table_registry.h>
#include <zephyr/sys/byteorder.h>
#include <zephyr/storage/flash_map.h>
#include <zephyr/drivers/flash/flash_simulator.h>
#include <errno.h>
#include <string.h>
#include <zephyr/ztest.h>

/* 仅用于验证绕过发布接口会被拒绝。 */
ZBUS_CHAN_DECLARE(dp_samples_chan);

ZTEST(points, test_product_port_registration_is_idempotent)
{
    zassert_ok(protocol_ports_init());
    zassert_ok(protocol_ports_init());
}

static const struct dp_key remote_di = {DEVICE_REMOTE_IO, SIGNAL_DI};
static const struct dp_key local_di = {DEVICE_LOCAL, SIGNAL_DI};
static struct dp_equip_cfg test_cfg;
static struct dp_point_cfg test_points[CONFIG_DP_POINTS_MAX_POINTS];
static struct dp_transmit_cfg test_transmit[80];
static struct test_local_sample local_sample;
int north_client;
static int north_server;
static int south_client;
static struct modbus_adu north_reply;

static struct dp_point_state state_of(struct dp_key key)
{
    struct dp_point_state state;
    zassert_ok(dp_read(key, &state));
    return state;
}

static void wait_after(struct dp_key key, uint32_t generation)
{
    for (int i = 0; i < 200; ++i) {
        if (state_of(key).generation > generation) {
            return;
        }
        k_msleep(1);
    }
    zassert_unreachable("processor did not consume batch");
}

static void poll_block(size_t block, int expected)
{
    zassert_true(block < test_cfg.collect_count);
    struct dp_key key = {
        test_cfg.collect[block].dev_id, test_cfg.collect[block].fields[0].sig_id,
    };
    uint32_t old = state_of(key).generation;
    zassert_equal(co_poll(block), expected);
    wait_after(key, old);
}

static void poll_signal(uint16_t sig, int expected)
{
    for (size_t i = 0; i < test_cfg.collect_count; ++i) {
        if (test_cfg.collect[i].dev_id == DEVICE_REMOTE_IO &&
            test_cfg.collect[i].fields[0].sig_id == sig) {
            poll_block(i, expected);
            return;
        }
    }
    zassert_unreachable("Missing poll for signal %u", sig);
}

static int north_request(int iface, const struct modbus_adu *adu, void *data)
{
    ARG_UNUSED(iface);
    ARG_UNUSED(data);
    return modbus_raw_submit_rx(north_server, adu);
}

static int north_response(int iface, const struct modbus_adu *adu, void *data)
{
    ARG_UNUSED(iface);
    ARG_UNUSED(data);
    north_reply = *adu;
    return modbus_raw_submit_rx(north_client, adu);
}

/* 构建目录内的适配实现也接受标准单字节 RAW 异常。 */
static void assert_exception(int result, uint8_t function, uint8_t code)
{
    zassert_equal(result, code);
    zassert_equal(north_reply.fc, function | 0x80);
    zassert_equal(north_reply.length, 1);
    zassert_equal(north_reply.data[0], code);
}

static int reject_42(const struct dp_point_cfg *cfg, struct dp_value *value,
                     const struct dp_value *old)
{
    ARG_UNUSED(cfg);
    ARG_UNUSED(old);
    return value->words[0] == 42 ? -ERANGE : 0;
}

void module_add_points(struct dp_equip_cfg *, struct dp_point_cfg *, struct dp_transmit_cfg *);
void module_bus_init(const struct dp_equip_cfg *);

static const struct dp_equip_cfg *app_cfg;

static void *setup(void)
{
    zassert_ok(protocol_register_point_tables());
    zassert_ok(dp_reference_prepare(&app_cfg));
    zassert_not_null(app_cfg);
    test_cfg = *app_cfg;
    for (size_t i = 0; i < app_cfg->point_count; ++i) {
        struct dp_point_cfg scratch;
        test_points[i] = *dp_config_point(app_cfg, i, &scratch);
    }
    test_cfg.point_get = NULL;
    test_cfg.points = test_points;
    test_points[test_cfg.point_count++] = (struct dp_point_cfg){
        .key = {1, 11000}, .source = DP_SOURCE_LOCAL, .type = DP_S16,
        .width = 1, .minimum = -1000, .maximum = 1000,
    };
    test_points[test_cfg.point_count++] = (struct dp_point_cfg){
        .key = {1, 11001}, .source = DP_SOURCE_LOCAL, .type = DP_S32,
        .width = 2, .minimum = INT32_MIN, .maximum = INT32_MAX,
    };
    test_points[test_cfg.point_count++] = (struct dp_point_cfg){
        .key = {1, 31100}, .source = DP_SOURCE_PARAMETER, .type = DP_U16,
        .width = 1, .maximum = 1000, .initial.words = {10},
        .param_flags = DP_PARAM_WRITE | DP_PARAM_PERSIST | DP_PARAM_RESTORE,
        .prepare_write = reject_42,
    };
    test_points[test_cfg.point_count++] = (struct dp_point_cfg){
        .key = {1, 31101}, .source = DP_SOURCE_PARAMETER, .type = DP_U16,
        .width = 1, .maximum = 1000, .initial.words = {7},
        .param_flags = DP_PARAM_PERSIST, /* 可读、不可变、不可恢复默认值。 */
    };
    const struct dp_registered_table *mapping;
    zassert_ok(dp_table_registry_find(protocol_forwarding.transmit_table, PRO_MB_SLAVE, &mapping));
    for (size_t i = 0; i < mapping->count; ++i) {
        zassert_ok(dp_transmit_from_reference(&((const MB_TABLE_CELL_T *)mapping->rows)[i],
                                               &test_transmit[i]));
    }
    test_cfg.transmit_count = mapping->count;
    test_cfg.transmit_get = NULL;
    test_cfg.transmit = test_transmit;
    test_transmit[test_cfg.transmit_count++] = (struct dp_transmit_cfg){
        .function = 4, .address = 11000, .count = 1, .key = {1, 11000},
    };
    test_transmit[test_cfg.transmit_count++] = (struct dp_transmit_cfg){
        .function = 4, .address = 11001, .count = 2, .key = {1, 11001},
        .order = DP_HIGH_WORD_FIRST,
    };
    module_add_points(&test_cfg, test_points, test_transmit);
    zassert_ok(dp_init_config(&test_cfg)); fixture_start_dp();
    zassert_equal(state_of(remote_di).quality, DP_QUALITY_UNINITIALIZED);
    uint16_t initial;
    zassert_equal(tr_read_register(4, 10000, &initial), -EIO);
    zassert_equal(tr_read_register(4, 8149, &initial), -EIO);
    zassert_ok(protocol_ports_init());
    south_client = co_port_open(&protocol_collect_port);
    zassert_true(south_client >= 0);
    fixture_connect_points();
    zassert_ok(co_init(&test_cfg, south_client, true));
    module_bus_init(&test_cfg);
    zassert_ok(dp_params_init(&test_cfg, DT_FIXED_PARTITION_ID(DT_ALIAS(idu_settings))));
    zassert_ok(dp_process_init_device(0));
    zassert_ok(tr_read_register(4, 8149, &initial));
    north_server = modbus_iface_get_by_name("RAW_2");
    north_client = modbus_iface_get_by_name("RAW_3");
    struct modbus_iface_param server = {
        .mode = MODBUS_MODE_RAW,
        .server = {.unit_id = 16, .user_cb = tr_callbacks()},
        .rawcb = {.raw_tx_cb = north_response},
    };
    struct modbus_iface_param client = {
        .mode = MODBUS_MODE_RAW, .rx_timeout = 2000000,
        .rawcb = {.raw_tx_cb = north_request},
    };
    zassert_ok(tr_register_attach(north_server, NULL));
    fixture_bind_tr(north_server);
    zassert_ok(tr_modbus_init_server(north_server, server, tr_register_write, true));
    zassert_ok(modbus_init_client(north_client, client));
    return NULL;
}

void parameter_before(void);
void parameter_after(void);

static void before(void *fixture)
{
    ARG_UNUSED(fixture);
    parameter_before();
    co_simulator_set_online(&idu_collect_simulator, true);
    zassert_ok(co_simulator_set_register(&idu_collect_simulator, 4, 8152, 0x0005));
    zassert_ok(co_simulator_set_register(&idu_collect_simulator, 4, 8150, 0x0101));
    zassert_ok(co_simulator_set_register(&idu_collect_simulator, 4, 8151, 0x0100));
    zassert_ok(co_simulator_set_register(&idu_collect_simulator, 3, 30459, 1));
    for (int i = 0; i < 8; ++i) {
        zassert_ok(co_simulator_set_register(&idu_collect_simulator, 4, 8163 + i, (i + 1) * 100));
    }
    for (size_t i = 0; i < test_cfg.collect_count; ++i) {
        /* 本套件只有设备 10 的模拟从机；双设备真实收发由 shared_rs485 覆盖。 */
        if (test_cfg.collect[i].dev_id != DEVICE_REMOTE_IO) { continue; }
        poll_block(i, 0);
    }
    local_sample = (struct test_local_sample){.di = 0xa55a, .address = 16, .valid = true};
    for (unsigned i = 0; i < SAMPLE_ANALOG_COUNT; ++i) {
        local_sample.raw[i] = i == 7 ? 4095 : i * 256;
    }
    uint32_t old = state_of(local_di).generation;
    zassert_ok(test_publish_sample(&local_sample));
    wait_after(local_di, old);
}

ZTEST(points, test_local_point_registers)
{
    uint16_t wire[15];
    zassert_ok(modbus_read_input_regs(north_client, 16, 8149, wire, 4));
    zassert_equal(wire[0], DEVICE_TYPE);
    zassert_equal(wire[1], PROTOCOL_VERSION & 0xffff);
    zassert_equal(wire[2], PROTOCOL_VERSION >> 16);
    zassert_equal(wire[3], local_sample.di);
    zassert_ok(modbus_read_input_regs(north_client, 16, 8163, wire, 8));
    for (size_t i = 0; i < SAMPLE_ANALOG_COUNT; ++i) {
        zassert_equal(wire[i], test_current_value(local_sample.raw[i]));
    }
    zassert_ok(modbus_read_input_regs(north_client, 16, 2504, wire, 1));
    zassert_equal(wire[0], 0x5347);
    zassert_ok(modbus_read_input_regs(north_client, 16, 2581, wire, 15));
    zassert_equal(wire[0], 0x4944);
    zassert_ok(modbus_read_holding_regs(north_client, 16, 30459, wire, 1));
    zassert_equal(wire[0], 1);
    const uint16_t unmapped[] = {2514, 4805, 4813, 4814, 4989, 5487, 8153, 8171};
    for (size_t i = 0; i < ARRAY_SIZE(unmapped); ++i) {
        assert_exception(modbus_read_input_regs(north_client, 16, unmapped[i], wire, 1),
                         4, MODBUS_EXC_ILLEGAL_DATA_ADDR);
    }
}


ZTEST(points, test_synchronous_local_set_is_immediately_visible_to_forwarding)
{
    uint8_t bytes[2];
    sys_put_le16(0x369c, bytes);
    zassert_ok(dp_set_sig_value(DEVICE_LOCAL, SIGNAL_DI, sizeof(bytes), bytes));
    zassert_equal(state_of(local_di).value.words[0], 0x369c);
    zassert_equal(state_of(local_di).quality, DP_QUALITY_GOOD);
    uint16_t wire;
    zassert_ok(tr_read_register(4, 8152, &wire));
    zassert_equal(wire, 0x369c);
}

ZTEST(points, test_end_to_end_remote_forwarding)
{
    uint16_t wire[3];
    zassert_ok(modbus_read_input_regs(north_client, 16, 10000, wire, ARRAY_SIZE(wire)));
    zassert_equal(wire[0], 5);
    for (unsigned i = 0; i < 2; ++i) {
        zassert_equal(wire[i + 1], (i + 1) * 100);
    }
    assert_exception(modbus_read_input_regs(north_client, 16, 10009, wire, 1),
                     4, MODBUS_EXC_ILLEGAL_DATA_ADDR);
    zassert_ok(modbus_read_input_regs(north_client, 16, 10010, wire, 3));
    zassert_equal(wire[0], 0x0101);
    zassert_equal(wire[1], 0x0100);
    zassert_equal(wire[2], 1);
    zassert_ok(modbus_read_holding_regs(north_client, 16, 30460, wire, 1));
    zassert_equal(wire[0], 1);
    zassert_equal(state_of(local_di).value.words[0], 0xa55a);
    zassert_equal(state_of(local_di).quality, DP_QUALITY_GOOD);
}

ZTEST(points, test_timeout_invalidates_and_recovers)
{
    co_simulator_set_online(&idu_collect_simulator, false);
    poll_block(0, -ETIMEDOUT);
    struct dp_point_state state = state_of(remote_di);
    zassert_equal(state.quality, DP_QUALITY_SIMULATED | DP_QUALITY_COMM_ERROR);
    zassert_equal(state.error, -ETIMEDOUT);
    uint16_t value;
    assert_exception(modbus_read_input_regs(north_client, 16, 10000, &value, 1),
                     4, MODBUS_EXC_ILLEGAL_DATA_ADDR);
    assert_exception(modbus_read_input_regs(north_client, 16, 10009, &value, 1),
                     4, MODBUS_EXC_ILLEGAL_DATA_ADDR);
    co_simulator_set_online(&idu_collect_simulator, true);
    zassert_ok(co_simulator_set_register(&idu_collect_simulator, 4, 8152, 0x55aa));
    poll_block(0, 0);
    zassert_ok(modbus_read_input_regs(north_client, 16, 10000, &value, 1));
    zassert_equal(value, 0x55aa);
}

ZTEST(points, test_reference_tables_do_not_enable_age_expiry)
{
    k_msleep(2001);
    zassert_equal(state_of(remote_di).quality, DP_QUALITY_SIMULATED | DP_QUALITY_GOOD);
    uint16_t value;
    zassert_ok(tr_read_register(4, 10000, &value));
    zassert_ok(tr_read_register(4, 8149, &value)); /* 常量永不过期。 */
    poll_block(0, 0);
    zassert_ok(tr_read_register(4, 10000, &value));
}

ZTEST(points, test_batch_error_and_remote_range_rejection)
{
    struct dp_key key = {DEVICE_LOCAL, SIGNAL_CURRENT_1};
    uint32_t old = state_of(key).generation;
    local_sample.raw[0] = 4096;
    zassert_ok(test_publish_sample(&local_sample));
    wait_after(key, old);
    zassert_equal(state_of(key).quality, DP_QUALITY_COMM_ERROR);
    zassert_equal(state_of(key).error, -ERANGE);
    uint16_t value;
    zassert_equal(tr_read_register(4, 8163, &value), -EIO);
    old = state_of(key).generation;
    local_sample.raw[0] = 2048;
    zassert_ok(test_publish_sample(&local_sample));
    wait_after(key, old);
    zassert_ok(tr_read_register(4, 8163, &value));
    zassert_equal(value, 34375);
    /* 语法正确的 Modbus 成功响应仍可能违反测点范围。 */
    zassert_ok(co_simulator_set_register(&idu_collect_simulator, 3, 30459, 0));
    poll_signal(SIGNAL_ADDRESS, 0);
    key = (struct dp_key){DEVICE_REMOTE_IO, SIGNAL_ADDRESS};
    zassert_equal(state_of(key).quality, DP_QUALITY_SIMULATED | DP_QUALITY_BAD_VALUE);
}

ZTEST(points, test_signed_values_and_word_order)
{
    struct dp_point_batch batch = {
        .source = DP_SOURCE_LOCAL, .count = 2,
        .points = {
            {.key = {1, 11000}, .width = 1, .value.words = {(uint16_t)-123}},
            {.key = {1, 11001}, .width = 2, .value.words = {0x3344, 0x8122}},
        },
    };
    uint32_t old = state_of(batch.points[0].key).generation;
    zassert_ok(dp_publish(&batch, K_MSEC(20)));
    wait_after(batch.points[0].key, old);
    uint16_t wire[3];
    zassert_ok(modbus_read_input_regs(north_client, 16, 11000, wire, 3));
    zassert_equal(wire[0], (uint16_t)-123);
    zassert_equal(wire[1], 0x8122);
    zassert_equal(wire[2], 0x3344);
    zassert_ok(co_simulator_set_register(&idu_collect_simulator, 4, 8150, 0x3344));
    zassert_ok(co_simulator_set_register(&idu_collect_simulator, 4, 8151, 0x1122));
    poll_signal(SIGNAL_PROTOCOL, 0);
    zassert_ok(modbus_read_input_regs(north_client, 16, 10010, wire, 2));
    zassert_equal(wire[0], 0x3344);
    zassert_equal(wire[1], 0x1122);
}

ZTEST(points, test_invalid_batch_cannot_partially_update_store)
{
    struct dp_point_batch batch = {
        .source = DP_SOURCE_LOCAL, .count = 2,
        .points = {
            {.key = {DEVICE_LOCAL, SIGNAL_DI}, .width = 1, .value.words = {0}},
            {.key = {99, 123}, .width = 1},
        },
    };
    struct dp_point_state old = state_of(local_di);
    zassert_equal(dp_publish(&batch, K_NO_WAIT), -ENOENT);
    /* 即使直接使用公开的 zbus 通道，也会执行校验。 */
    zassert_true(zbus_chan_pub(&dp_samples_chan, &batch, K_NO_WAIT) < 0);
    batch.count = 1;
    batch.source = DP_SOURCE_MODBUS;
    zassert_equal(dp_publish(&batch, K_NO_WAIT), -EINVAL);
    batch.source = DP_SOURCE_LOCAL;
    batch.points[0].key.sig_id = SIGNAL_SAMPLE_PERIOD; /* 遥测输入不能写参数。 */
    zassert_equal(dp_publish(&batch, K_NO_WAIT), -EINVAL);
    uint8_t identity[2] = {0};
    zassert_equal(dp_set_sig_value(DEVICE_LOCAL, 8149, sizeof(identity), identity), -EACCES);
    k_msleep(2);
    zassert_equal(state_of(local_di).generation, old.generation);
    zassert_equal(state_of(local_di).value.words[0], old.value.words[0]);
}

ZTEST(points, test_burst_messages_are_processed_individually)
{
    struct dp_point_batch batch = {
        .source = DP_SOURCE_LOCAL, .count = 1,
        .points = {{.key = {DEVICE_LOCAL, SIGNAL_DI}, .width = 1}},
    };
    uint32_t old = state_of(local_di).generation;
    for (unsigned i = 0; i < 20; ++i) {
        batch.points[0].value.words[0] = i;
        zassert_ok(dp_publish(&batch, K_MSEC(100)));
    }
    for (unsigned i = 0; i < 200 && state_of(local_di).generation < old + 20; ++i) {
        k_msleep(1);
    }
    struct dp_point_state state = state_of(local_di);
    zassert_equal(state.generation, old + 20);
    zassert_equal(state.value.words[0], 19);
}

ZTEST(points, test_unknown_register_and_writes_rejected)
{
    uint16_t value = 0;
    assert_exception(modbus_read_input_regs(north_client, 16, 10013, &value, 1),
                     4, MODBUS_EXC_ILLEGAL_DATA_ADDR);
    zassert_ok(modbus_write_holding_reg(north_client, 16, 30459, 2));
    assert_exception(modbus_write_holding_regs(north_client, 16, 30459, &value, 1),
                     16, MODBUS_EXC_ILLEGAL_DATA_VAL);
    zassert_equal(modbus_read_input_regs(north_client, 17, 10000, &value, 1), -ETIMEDOUT);
    /* 有效 RAW 异常现在以协议异常形式传到客户端。 */
    zassert_equal(modbus_read_input_regs(south_client, 1, 99, &value, 1),
                  MODBUS_EXC_ILLEGAL_DATA_ADDR);
}

ZTEST(points, test_queue_full_returns_error_and_recovers)
{
    struct dp_point_batch batch = {
        .source = DP_SOURCE_LOCAL, .count = 1,
        .points = {{.key = {DEVICE_LOCAL, SIGNAL_DI}, .width = 1}},
    };
    uint32_t old = state_of(local_di).generation;
    int results[CONFIG_DP_POINTS_QUEUE_DEPTH + 1];
    k_sched_lock();
    for (size_t i = 0; i < ARRAY_SIZE(results); ++i) {
        batch.points[0].value.words[0] = i;
        results[i] = dp_publish(&batch, K_NO_WAIT);
    }
    k_sched_unlock();
    for (int i = 0; i < CONFIG_DP_POINTS_QUEUE_DEPTH; ++i) {
        zassert_ok(results[i]);
    }
    zassert_true(results[CONFIG_DP_POINTS_QUEUE_DEPTH] < 0);
    for (int i = 0; i < 200 && state_of(local_di).generation <
         old + CONFIG_DP_POINTS_QUEUE_DEPTH; ++i) {
        k_msleep(1);
    }
    zassert_equal(state_of(local_di).generation, old + CONFIG_DP_POINTS_QUEUE_DEPTH);
    zassert_equal(state_of(local_di).value.words[0], CONFIG_DP_POINTS_QUEUE_DEPTH - 1);
    old = state_of(local_di).generation;
    zassert_ok(dp_publish(&batch, K_MSEC(20)));
    wait_after(local_di, old);
}

ZTEST(points, test_positive_modbus_exception_invalidates_sample)
{
    struct dp_point_batch batch = {
        .source = DP_SOURCE_MODBUS, .flags = DP_QUALITY_SIMULATED, .count = 1,
        .points = {{.key = {DEVICE_REMOTE_IO, SIGNAL_DI}, .width = 1,
                    .error = MODBUS_EXC_ILLEGAL_DATA_ADDR}},
    };
    uint32_t old = state_of(remote_di).generation;
    zassert_ok(dp_publish(&batch, K_MSEC(20)));
    wait_after(remote_di, old);
    zassert_equal(state_of(remote_di).quality, DP_QUALITY_SIMULATED | DP_QUALITY_COMM_ERROR);
    zassert_equal(state_of(remote_di).error, MODBUS_EXC_ILLEGAL_DATA_ADDR);
}

ZTEST(points, test_configuration_validation)
{
    struct dp_equip_cfg cfg = *app_cfg;
    zassert_ok(dp_validate(&cfg));
    struct dp_point_cfg scratch;
    struct dp_point_cfg first = *dp_config_point(&cfg, 0, &scratch);
    struct dp_point_cfg points[2] = {first, first};
    struct dp_equip_cfg small = {.points = points, .point_count = 2};
    zassert_equal(dp_validate(&small), -EEXIST);
    small.point_count = 1;
    points[0].width = 2;
    zassert_equal(dp_validate(&small), -EINVAL);
    points[0] = first;
    struct dp_transmit_cfg map = {.function = 3, .address = 31090,
                                  .count = 1, .key = first.key};
    struct dp_transmit_cfg maps[2] = {map, map};
    small.transmit = maps;
    small.transmit_count = 2;
    zassert_equal(dp_validate(&small), -EEXIST);
    small.transmit_count = 1;
    maps[0].key.sig_id = 9999;
    zassert_equal(dp_validate(&small), -EINVAL);
    maps[0] = (struct dp_transmit_cfg){
        .function = 4, .address = 65535, .count = 2, .kind = DP_MAP_ZERO,
    };
    zassert_equal(dp_validate(&small), -EINVAL);
    struct co_cfg collect;
    zassert_not_null(dp_config_collect(&cfg, 0, &collect));
    cfg.collect_get = NULL;
    cfg.collect = &collect;
    cfg.collect_count = 1;
    collect.count = CO_MAX_REGS + 1;
    zassert_equal(dp_validate(&cfg), -EINVAL);
    collect.count = 1;
    collect.dev_id = 999;
    zassert_equal(dp_validate(&cfg), -EINVAL);
    zassert_equal(dp_init_config(app_cfg), -EALREADY);
}

static void after(void *fixture)
{
    ARG_UNUSED(fixture);
    parameter_after();
}

ZTEST_SUITE(points, NULL, setup, before, after, NULL);

static K_SEM_DEFINE(config_done,0,1);
static int config_error;
static bool fail_config_init;
int __real_modbus_init_server(int iface, struct modbus_iface_param param);
int __wrap_modbus_init_server(int iface, struct modbus_iface_param param)
{
    if (fail_config_init && param.server.unit_id==19) {
        fail_config_init=false; return -EIO;
    }
    return __real_modbus_init_server(iface,param);
}
static void reconfigured(int iface, int error, void *user)
{
    ARG_UNUSED(user); zassert_equal(iface,north_server);
    config_error=error; k_sem_give(&config_done);
}
static int configure_segment(int iface, const struct modbus_adu *rx, struct modbus_adu *tx, void *user)
{
    ARG_UNUSED(user);
    struct modbus_iface_param param={.mode=MODBUS_MODE_RAW,
        .server={.unit_id=sys_get_be16(rx->data+2),.user_cb=tr_callbacks()},
        .rawcb={.raw_tx_cb=north_response}};
    int err=tr_modbus_reconfigure(iface,param,reconfigured,NULL);
    if (!err) { *tx=*rx; }
    return err;
}
ZTEST(points,test_modules_dynamic_port_configuration_and_routes)
{
    static const struct tr_segment segments[]={
        {.begin=52000,.end=52000,.function=6,.handler=configure_segment},
        {.begin=50000,.end=50003,.target_dev=20,.target_begin=40000},
    };
    static const struct tr_routes routes={.segments=segments,.count=ARRAY_SIZE(segments)};
    zassert_ok(tr_attach(north_server,&routes));
    uint16_t word;
    /* 后端初始化失败必须恢复最近可用配置；连续第二次重配置也失败时同样如此。 */
    struct modbus_iface_param invalid={.mode=MODBUS_MODE_RAW,
        .server={.unit_id=19,.user_cb=tr_callbacks()},
        .rawcb={.raw_tx_cb=north_response}};
    for (int i=0;i<2;++i) {
        fail_config_init=true;
        zassert_ok(tr_modbus_reconfigure(north_server,invalid,reconfigured,NULL));
        zassert_ok(k_sem_take(&config_done,K_SECONDS(1)));
        zassert_true(config_error<0 && config_error!=-ENOTRECOVERABLE);
        zassert_ok(modbus_read_holding_regs(north_client,16,31000,&word,1));
    }
    zassert_ok(modbus_read_holding_regs(north_client,16,50000,&word,1)); zassert_equal(word,100);
    zassert_ok(modbus_write_holding_reg(north_client,16,50000,123));
    zassert_ok(modbus_read_holding_regs(north_client,16,50000,&word,1)); zassert_equal(word,123);
    zassert_equal(modbus_write_holding_reg(north_client,16,52000,0),MODBUS_EXC_ILLEGAL_DATA_VAL);
    zassert_ok(modbus_write_holding_reg(north_client,16,52000,17));
    zassert_equal(north_reply.unit_id,16); zassert_equal(north_reply.fc,6);
    zassert_ok(k_sem_take(&config_done,K_SECONDS(1))); zassert_ok(config_error);
    zassert_ok(modbus_read_holding_regs(north_client,17,31000,&word,1));
    zassert_ok(modbus_write_holding_reg(north_client,17,52000,16));
    zassert_ok(k_sem_take(&config_done,K_SECONDS(1))); zassert_ok(config_error);
    zassert_ok(modbus_read_holding_regs(north_client,16,31000,&word,1));
    zassert_ok(tr_register_attach(north_server, NULL));
}
```

## src/modules.c
```c
#include "../../fixtures/co_tasks.h"
#include "../../fixtures/point_connections.h"
#include "simulation.h"
#include "protocol/inc/protocol.h"
#include <collect/simulator.h>
#include "protocol/inc/signal_ids.h"
#include <dataprocess/params.h>
#include <dataprocess/points.h>
#include <dataprocess/process.h>
#include <collect/collect.h>
#include <transmit/transmit.h>
#include <zephyr/ztest.h>
#include <zephyr/sys/byteorder.h>
#include <errno.h>
#include <string.h>

static struct dp_device_cfg devices[CONFIG_DP_MAX_DEVICES];
static struct co_cfg collect_blocks[CONFIG_DP_POINTS_MAX_POLLS];
static uint16_t bus_value = 100;
static int bus_fault;
static unsigned callback_count, timer_count, reboot_count;
static bool slow_handler;
extern int north_client;
static uint16_t callback_port;
static struct dp_key input = {1, 11200}, output = {1, 11201}, dynamic = {1, 11202};
static struct dp_key remote2 = {20, 1200};

void dp_process_reboot(void) { ++reboot_count; }
unsigned module_reboot_count(void) { return reboot_count; }

static unsigned action_calls;
static int action_error, action_validation_error;
static bool action_derived;

static int command_action(uint16_t argument)
{
    zassert_equal(argument, 17);
    ++action_calls;
    return action_error;
}

static int32_t command_callback(FUNC_PARA_ALL *in, FUNC_PARA_ALL *out,
                                 void *new_value, void *old_value)
{
    ARG_UNUSED(out); ARG_UNUSED(new_value); ARG_UNUSED(old_value);
    if (in->type != DP_PARA_SET) { return 0; }
    int err = dp_defer_para_action(command_action, 17);
    if (err) { return err; }
    if (action_derived) {
        uint16_t value = 10;
        return dp_set_para_only_dm(1, 11201, sizeof(value), (uint8_t *)&value);
    }
    return action_validation_error;
}

static int linked(struct dp_process_ctx *ctx, struct dp_key key)
{
    struct dp_value candidate, old;
    ++callback_count; callback_port = ctx->request->port_id;
    if (ctx->request->operation == DP_OP_INIT) {
        candidate = (struct dp_value){.words = {7}};
        return dp_txn_emit(ctx, output, &candidate, DP_OP_NO_COLLECT | DP_OP_NO_STORE);
    }
    if (ctx->request->operation == DP_OP_TIMER) {
        ++timer_count;
        candidate = (struct dp_value){.words = {timer_count}};
        return dp_txn_emit(ctx, output, &candidate, DP_OP_NO_COLLECT | DP_OP_NO_STORE);
    }
    if (ctx->request->operation == DP_OP_READ) {
        candidate = (struct dp_value){.words = {1234}};
        return dp_txn_emit(ctx, key, &candidate, DP_OP_NO_COLLECT | DP_OP_NO_STORE);
    }
    if (slow_handler) { k_sleep(K_MSEC(70)); }
    zassert_true(dp_txn_contains(ctx, input));
    zassert_false(dp_txn_contains(ctx, output));
    zassert_ok(dp_txn_get(ctx, input, false, &candidate));
    zassert_ok(dp_txn_get(ctx, input, true, &old));
    candidate.words[0] *= 2;
    int err = dp_txn_emit(ctx, output, &candidate, DP_OP_NO_COLLECT | DP_OP_NO_STORE);
    candidate.words[0] = candidate.words[0] / 2 + 10;
    return err ? err : dp_txn_emit(ctx, (struct dp_key){1, 31100}, &candidate,
                                   DP_OP_NO_COLLECT | DP_OP_NO_STORE);
}

static int second_bus(void *user, uint16_t dev_id, struct modbus_adu *adu,
                     k_timeout_t timeout)
{
    ARG_UNUSED(timeout);
    ARG_UNUSED(dev_id);
    ARG_UNUSED(user);
    if (bus_fault) { return bus_fault; }
    if (adu->fc == 3 && adu->length == 4 && sys_get_be16(adu->data + 2) == 1) {
        adu->data[0] = 2; sys_put_be16(bus_value, adu->data + 1); adu->length = 3; return 0;
    }
    if (adu->fc == 6 && adu->length == 4) {
        bus_value = sys_get_be16(adu->data + 2); return 0;
    }
    return -ENOTSUP;
}

void module_add_points(struct dp_equip_cfg *cfg, struct dp_point_cfg *points,
                        struct dp_transmit_cfg *maps)
{
    for (size_t i = 0; i < cfg->collect_count; ++i) {
        struct co_cfg scratch;
        const struct co_cfg *poll = dp_config_collect(cfg, i, &scratch);
        collect_blocks[i] = *poll;
        if (poll->fields == &scratch.reference_field) {
            collect_blocks[i].fields = &collect_blocks[i].reference_field;
        }
    }
    cfg->collect_get = NULL;
    collect_blocks[0].init_only=true;
    cfg->collect=collect_blocks;
    size_t count = cfg->device_count;
    zassert_true(count < ARRAY_SIZE(devices));
    memcpy(devices, cfg->devices, count * sizeof(*devices));
    devices[count] = (struct dp_device_cfg){.dev_id = 20, .unit_id = 1, .bus_id = 1};
    cfg->devices = devices; cfg->device_count = count + 1;
    points[cfg->point_count++] = (struct dp_point_cfg){.key = input,
        .source = DP_SOURCE_LOCAL, .type = DP_U16, .width = 1, .maximum = 1000, .handler = linked};
    points[cfg->point_count++] = (struct dp_point_cfg){.key = output,
        .source = DP_SOURCE_LOCAL, .type = DP_U16, .width = 1, .maximum = 2000};
    points[cfg->point_count++] = (struct dp_point_cfg){.key = dynamic,
        .source = DP_SOURCE_LOCAL, .type = DP_U16, .width = 1, .maximum = 2000,
        .handler = linked, .read_callback = true};
    points[cfg->point_count++] = (struct dp_point_cfg){.key = remote2,
        .source = DP_SOURCE_PARAMETER, .type = DP_U16, .width = 1, .maximum = 1000,
        .param_flags = DP_PARAM_WRITE | DP_PARAM_PERSIST | DP_PARAM_FORWARD | DP_PARAM_RESTORE,
        .initial.words = {100}, .write_address = 40000};
    points[cfg->point_count++] = (struct dp_point_cfg){
        .key = {1, 11203}, .source = DP_SOURCE_LOCAL, .type = DP_U16,
        .width = 1, .maximum = 1, .reference_data_type = DATA_TYPE_U16,
        .size_bytes = 2, .handler = dp_reference_process,
        .reference_handler = command_callback,
    };
    maps[cfg->transmit_count++] = (struct dp_transmit_cfg){
        .function = 3, .address = 31200, .count = 1, .key = {1, 11203},
    };
    for (unsigned order=0;order<4;++order) {
        maps[cfg->transmit_count++] = (struct dp_transmit_cfg){.function=4,.address=11300+2*order,
            .count=2,.key={1,11001},.order=order};
        maps[cfg->transmit_count++] = (struct dp_transmit_cfg){.function=3,.address=31600+2*order,
            .count=2,.key={DEVICE_REMOTE_IO,SIGNAL_REMOTE_OFFSET},.order=order};
    }
    maps[cfg->transmit_count++] = (struct dp_transmit_cfg){.function = 4, .address = 11202,
        .count = 1, .key = dynamic};
}

void module_bus_init(const struct dp_equip_cfg *cfg)
{
    struct co_bus_cfg bus = {.id = 1, .iface = -1, .simulated = false, .transfer = second_bus};
    fixture_connect_points();
    zassert_ok(co_init_bus(cfg, &bus));
    for (size_t i = 0; i < cfg->collect_count; ++i) { zassert_ok(co_enable_poll(i, false)); }
    zassert_ok(co_polling_init()); fixture_start_co();
}

static uint16_t value(struct dp_key key)
{
    struct dp_point_state state; zassert_ok(dp_read(key, &state)); return state.value.words[0];
}

ZTEST(points, test_modules_process_linked_outputs_and_read_init)
{
    callback_count = 0;
    struct dp_process_request req = {.operation = DP_OP_WRITE, .id = 123, .port_id = 9, .count = 1,
        .items[0].point = {.key = input, .width = 1, .value.words = {20}}};
    struct dp_process_result result;
    zassert_ok(dp_process_execute(&req, &result));
    zassert_equal(result.id, 123); zassert_equal(result.count, 3);
    zassert_equal(callback_count, 1); zassert_equal(callback_port, 9);
    zassert_equal(value(output), 40); zassert_equal(value((struct dp_key){1,31100}), 30);
    zassert_ok(dp_params_flush()); zassert_ok(dp_params_reload());
    zassert_equal(value((struct dp_key){1,31100}), 10); /* 关联的 NO_STORE 值从未泄露。 */
    struct dp_point_state state;
    zassert_ok(dp_process_read(dynamic, 12, &state));
    zassert_equal(state.value.words[0], 1234); zassert_equal(callback_port, 12);
    zassert_ok(dp_process_init_device(1)); zassert_equal(value(output), 7);
    req.items[0].point.value.words[0] = 2000;
    zassert_equal(dp_process_execute(&req, &result), -ERANGE);
    zassert_equal(value(output), 7); /* 校验失败后不提交任何输出。 */
}

static K_SEM_DEFINE(done_sem, 0, 8);
static struct dp_process_result completion;
static void completed(const struct dp_process_result *result, void *user)
{
    zassert_equal(user, &completion); completion = *result; k_sem_give(&done_sem);
}

ZTEST(points, test_modules_async_timer_and_save_reboot)
{
    struct dp_process_request req = {.operation = DP_OP_WRITE, .id = 321, .count = 1,
        .items[0].point = {.key = input, .width = 1, .value.words = {8}}};
    zassert_ok(dp_process_submit(&req, completed, &completion));
    req.items[0].point.value.words[0] = 999; /* 队列持有数值副本。 */
    zassert_ok(k_sem_take(&done_sem, K_SECONDS(1)));
    zassert_ok(completion.error); zassert_equal(completion.id, 321); zassert_equal(value(output), 16);
    timer_count = 0;
    int slot = dp_process_timer_start(input, 5, 0); zassert_true(slot >= 0);
    k_sleep(K_MSEC(50)); zassert_equal(timer_count, 1);
    k_sleep(K_MSEC(30)); zassert_equal(timer_count, 1);
    slot = dp_process_timer_start(input, 5, 10); zassert_true(slot >= 0);
    k_sleep(K_MSEC(60)); zassert_true(timer_count >= 3);
    zassert_ok(dp_process_timer_cancel(slot));
    unsigned before = timer_count; k_sleep(K_MSEC(40)); zassert_equal(timer_count, before);
    before = reboot_count; zassert_ok(dp_process_save_reboot(100));
    k_sleep(K_MSEC(150)); zassert_equal(reboot_count, before+1);
}

ZTEST(points, test_modules_parameter_operation_flags_and_deferred_store)
{
    struct dp_point_update update = {.key = {1,31100}, .width = 1, .value.words = {55}};
    zassert_ok(dp_params_apply(&update, 1, DP_OP_NO_STORE));
    zassert_equal(value(update.key), 55);
    struct dp_point_update another = {.key = {1, SIGNAL_SAMPLE_PERIOD}, .width = 1, .value.words = {600}};
    zassert_ok(dp_params_set_values(&another, 1));
    zassert_ok(dp_params_reload()); zassert_equal(value(update.key), 10);
    update.value.words[0] = 66;
    zassert_ok(dp_params_apply(&update, 1, DP_OP_DEFER));
    zassert_equal(value(update.key), 66);
    zassert_ok(dp_params_reload()); zassert_equal(value(update.key), 10);
    zassert_ok(dp_params_apply(&update, 1, DP_OP_DEFER));
    k_sleep(K_MSEC(1100)); zassert_ok(dp_params_reload()); zassert_equal(value(update.key), 66);
    update = (struct dp_point_update){.key = remote2, .width = 1, .value.words = {222}};
    unsigned before = bus_value;
    zassert_ok(dp_params_apply(&update, 1, DP_OP_NO_COLLECT | DP_OP_NO_STORE));
    zassert_equal(bus_value, before); zassert_equal(value(remote2), 222);
    update.value.words[0] = 333;
    zassert_ok(dp_params_apply(&update, 1, DP_OP_NO_DM));
    zassert_equal(bus_value, 333); zassert_equal(value(remote2), 222);
    zassert_ok(dp_params_reload()); zassert_equal(value(remote2), 100);
}

ZTEST(points, test_modules_multibus_modes_state_and_initialization)
{
    struct dp_point_update update = {.key = remote2, .width = 1, .value.words = {222}};
    zassert_ok(dp_params_set_values(&update, 1)); zassert_equal(bus_value, 222);
    zassert_ok(co_set_mode(1, CO_PORT_SLEEP));
    uint16_t word; zassert_equal(co_read(20, 3, 40000, &word, 1), -EBUSY);
    zassert_ok(co_read(DEVICE_REMOTE_IO, 4, 8152, &word, 1)); /* 其他总线不受影响。 */
    zassert_ok(co_set_mode(1, CO_PORT_POLL));
    bus_fault = -ETIMEDOUT;
    zassert_equal(co_read(20, 3, 40000, &word, 1), -ETIMEDOUT);
    struct co_device_status status; zassert_ok(co_device_status(20, &status));
    zassert_equal(status.state, CO_DEVICE_ONLINE);
    zassert_equal(status.last_error, -ETIMEDOUT);
    bus_fault = 2; zassert_equal(co_read(20, 3, 40000, &word, 1), 2);
    zassert_ok(co_device_status(20, &status)); zassert_equal(status.state, CO_DEVICE_ONLINE);
    zassert_equal(status.last_error, 2);
    bus_fault = 0; bus_value = 44;
    zassert_ok(co_initialize_device(20)); zassert_equal(bus_value, 222);
    zassert_ok(co_simulator_set_register(&idu_collect_simulator, 4,8152,0x27));
    zassert_ok(co_initialize_device(DEVICE_REMOTE_IO));
    zassert_equal(value((struct dp_key){DEVICE_REMOTE_IO,SIGNAL_DI}),0x27);
    zassert_ok(co_device_status(20, &status)); zassert_equal(status.state, CO_DEVICE_ONLINE);
}

static uint32_t order[4]; static unsigned completed_count;
static K_SEM_DEFINE(bus_done, 0, 8);
static void bus_completed(const struct co_request *reply, int error, void *user)
{
    ARG_UNUSED(user); zassert_ok(error); order[completed_count++] = reply->id; k_sem_give(&bus_done);
}
ZTEST(points, test_modules_priority_and_segment_passthrough)
{
    zassert_ok(co_set_mode(1, CO_PORT_SLEEP)); completed_count = 0;
    struct co_request request = {.dev_id = 20, .id = 1, .priority = 0, .mode=CO_PORT_PASSTHROUGH,
                                         .adu = {.fc = 3, .length = 4}};
    sys_put_be16(40000, request.adu.data); sys_put_be16(1, request.adu.data+2);
    zassert_ok(co_submit(&request, bus_completed, NULL));
    request.id = 2; request.priority = 3; zassert_ok(co_submit(&request, bus_completed, NULL));
    zassert_ok(co_set_mode(1, CO_PORT_PASSTHROUGH));
    zassert_ok(k_sem_take(&bus_done, K_SECONDS(1))); zassert_ok(k_sem_take(&bus_done, K_SECONDS(1)));
    zassert_equal(order[0], 2); zassert_equal(order[1], 1);
    struct tr_segment segment = {.begin=50000,.end=50003,.target_dev=20,.target_begin=40000};
    struct tr_routes routes = {.segments=&segment,.count=1};
    struct modbus_adu rx = {.unit_id=16,.fc=3,.length=4}, tx;
    sys_put_be16(50000,rx.data); sys_put_be16(1,rx.data+2);
    zassert_ok(tr_dispatch(2,&rx,&tx,&routes));
    zassert_equal(tx.unit_id,16); zassert_equal(sys_get_be16(tx.data+1),bus_value);
    sys_put_be16(50003,rx.data); sys_put_be16(2,rx.data+2);
    zassert_equal(tr_dispatch(2,&rx,&tx,&routes),-ERANGE);
    zassert_ok(co_set_mode(1, CO_PORT_POLL));
}

ZTEST(points, test_modules_all_four_byte_orders)
{
    const uint16_t words[] = {0x3344,0x1122};
    const uint16_t expected[][2] = {{0x3344,0x1122},{0x1122,0x3344},{0x4433,0x2211},{0x2211,0x4433}};
    for (int order = 0; order < 4; ++order) {
        uint16_t wire[2];
        for (int i=0;i<2;++i) { wire[i]=dp_order_word(words,2,i,order); zassert_equal(wire[i],expected[order][i]); }
        for (int i=0;i<2;++i) { zassert_equal(dp_order_word(wire,2,i,order),words[i]); }
    }
}

ZTEST(points, test_modules_sample_callbacks_keep_provenance)
{
    struct dp_point_batch batch={.source=DP_SOURCE_LOCAL,.flags=DP_QUALITY_SIMULATED,.count=1,
        .points[0]={.key=input,.width=1,.value.words={21}}};
    zassert_ok(dp_publish(&batch,K_MSEC(20)));
    k_sleep(K_MSEC(30));
    struct dp_point_state state; zassert_ok(dp_read(output,&state));
    zassert_equal(state.value.words[0],42);
    zassert_equal(state.quality,DP_QUALITY_SIMULATED|DP_QUALITY_GOOD);
    batch.points[0].value.words[0]=2000;
    zassert_ok(dp_publish(&batch,K_MSEC(20))); k_sleep(K_MSEC(30));
    zassert_equal(value(output),42);
    zassert_ok(dp_read(input,&state));
    zassert_equal(state.quality,DP_QUALITY_SIMULATED|DP_QUALITY_BAD_VALUE);
}

ZTEST(points, test_modules_busy_timer_retries_and_partial_results)
{
    timer_count=0; slow_handler=true;
    int timer=dp_process_timer_start(input,5,0); zassert_true(timer>=0);
    struct dp_process_request req={.operation=DP_OP_WRITE,.count=1,
        .items[0].point={.key=input,.width=1,.value.words={10}}};
    struct dp_process_result result;
    zassert_ok(dp_process_execute(&req,&result)); slow_handler=false;
    k_sleep(K_MSEC(50)); zassert_equal(timer_count,1);
    req.count=2;
    req.items[0].point=(struct dp_point_update){.key={1,31100},.width=1,.value.words={33}};
    req.items[1].point=(struct dp_point_update){.key=remote2,.width=1,.value.words={333}};
    bus_fault=-ETIMEDOUT;
    zassert_equal(dp_process_execute(&req,&result),-ETIMEDOUT); bus_fault=0;
    zassert_equal(result.count,2); zassert_ok(result.points[0].error);
    zassert_equal(result.points[1].error,-ETIMEDOUT);
    zassert_equal(value((struct dp_key){1,31100}),33); zassert_equal(value(remote2),100);
}

ZTEST(points, test_modules_four_orders_over_modbus)
{
    struct dp_point_update update={.key={1,11001},.width=2,.value.words={0x3344,0x1122}};
    zassert_ok(dp_commit(&update,1));
    const uint16_t expected[][2]={{0x3344,0x1122},{0x1122,0x3344},{0x4433,0x2211},{0x2211,0x4433}};
    for (int order=0;order<4;++order) {
        uint16_t wire[2];
        zassert_ok(modbus_read_input_regs(north_client,16,11300+2*order,wire,2));
        zassert_mem_equal(wire,expected[order],sizeof(wire));
        uint16_t canonical[2]={0x1234,0};
        for (int i=0;i<2;++i) { wire[i]=dp_order_word(canonical,2,i,order); }
        zassert_ok(modbus_write_holding_regs(north_client,16,31600+2*order,wire,2));
        zassert_equal(value((struct dp_key){DEVICE_REMOTE_IO,SIGNAL_REMOTE_OFFSET}),0x1234);
    }
}

static unsigned cancelled;
static void on_cancel(const struct co_request *request, int error, void *user)
{
    ARG_UNUSED(request); ARG_UNUSED(user); zassert_equal(error,-ECANCELED); ++cancelled;
}
ZTEST(points, test_modules_mode_ownership_and_cancel)
{
    zassert_ok(co_set_mode(1,CO_PORT_UPDATE));
    uint16_t word; zassert_equal(co_read(20,3,40000,&word,1),-EBUSY);
    struct co_request req={.dev_id=20,.adu={.fc=3,.length=4}};
    sys_put_be16(40000,req.adu.data); sys_put_be16(1,req.adu.data+2);
    cancelled=0;
    zassert_ok(co_submit(&req,on_cancel,NULL));
    k_sleep(K_MSEC(20)); zassert_equal(cancelled,0);
    zassert_ok(co_cancel(1)); zassert_equal(cancelled,1);
    zassert_ok(co_cancel(1)); zassert_equal(cancelled,1);
    zassert_ok(co_transfer_mode(20,CO_PORT_UPDATE,&req.adu));
    zassert_ok(co_set_mode(1,CO_PORT_POLL));
}

ZTEST(points, test_deferred_action_validates_before_effects)
{
    action_calls = 0; action_error = 0; action_validation_error = -EINVAL;
    zassert_equal(dp_defer_para_action(command_action, 17), -EPERM);
    zassert_equal(modbus_write_holding_reg(north_client, 16, 31200, 1),
                  MODBUS_EXC_ILLEGAL_DATA_VAL);
    action_validation_error = 0;
    /* 回调接受此值，最终范围校验仍须拒绝。 */
    zassert_equal(modbus_write_holding_reg(north_client, 16, 31200, 2),
                  MODBUS_EXC_ILLEGAL_DATA_VAL);
    action_derived = true;
    struct dp_point_state before, after;
    zassert_ok(dp_read(output, &before));
    zassert_equal(modbus_write_holding_reg(north_client, 16, 31200, 1),
                  MODBUS_EXC_ILLEGAL_DATA_VAL);
    action_derived = false;
    zassert_ok(dp_read(output, &after));
    zassert_equal(after.generation, before.generation);
    zassert_equal(action_calls, 0);
    zassert_ok(modbus_write_holding_reg(north_client, 16, 31200, 1));
    zassert_equal(action_calls, 1);
}

ZTEST(points, test_command_failure_is_not_treated_as_unhandled_route)
{
    action_calls = 0; action_validation_error = 0; action_derived = false;
    action_error = -ENOENT;
    zassert_equal(modbus_write_holding_reg(north_client, 16, 31200, 1),
                  MODBUS_EXC_ILLEGAL_DATA_ADDR);
    zassert_equal(action_calls, 1);
    action_error = -EIO;
    zassert_equal(modbus_write_holding_reg(north_client, 16, 31200, 1),
                  MODBUS_EXC_SERVER_DEVICE_FAILURE);
    zassert_equal(action_calls, 2);
    action_error = 0;
}
```

## src/storage_fault.c
```c
#include "storage_fault.h"
#include <errno.h>
#include <zephyr/kvss/nvs.h>
#include <zephyr/sys/atomic.h>
#include <zephyr/ztest.h>

/* 现有参数存储格式的 NVS ID；仅用于定位外部故障，不引用 DP 私有实现。 */
#define SETTINGS_INTENT_ID 2U
#define SETTINGS_META_ID 3U
#define SETTINGS_COMMIT_ID 4U
#define SETTINGS_VALUE_FIRST 0x100U
#define SETTINGS_VALUE_COUNT 1024U

static const char *const stage_names[] = {
    "none", "mount", "intent write", "commit journal write", "value write",
    "metadata write", "commit journal delete", "intent delete",
};

static const struct flash_area *target_area;
static atomic_t target_stage;
static atomic_t hits;

void storage_fault_reset(const struct flash_area *area)
{
    target_area = area;
    atomic_set(&target_stage, STORAGE_FAULT_NONE);
    atomic_clear(&hits);
}

void storage_fault_arm(storage_fault_stage_t stage)
{
    zassert_equal(atomic_get(&target_stage), STORAGE_FAULT_NONE);
    zassert_true(stage > STORAGE_FAULT_NONE && stage <= STORAGE_FAULT_INTENT_DELETE);
    zassert_not_null(target_area);
    atomic_clear(&hits);
    atomic_set(&target_stage, stage);
}

void storage_fault_finish(void)
{
    storage_fault_stage_t stage = atomic_get(&target_stage);
    atomic_set(&target_stage, STORAGE_FAULT_NONE);
    if (stage != STORAGE_FAULT_NONE) {
        zassert_equal(atomic_get(&hits), 1, "Storage fault stage '%s' was not reached",
                      stage_names[stage]);
    }
}

int __real_nvs_mount(struct nvs_fs *fs);
static bool should_fail(struct nvs_fs *fs, storage_fault_stage_t stage)
{
    return stage != STORAGE_FAULT_NONE && target_area &&
           fs->flash_device == flash_area_get_device(target_area) &&
           fs->offset == target_area->fa_off &&
           atomic_get(&target_stage) == stage && atomic_cas(&hits, 0, 1);
}

int __wrap_nvs_mount(struct nvs_fs *fs)
{
    return should_fail(fs, STORAGE_FAULT_MOUNT) ? -EIO : __real_nvs_mount(fs);
}

ssize_t __real_nvs_write(struct nvs_fs *fs, uint16_t id, const void *data, size_t len);
ssize_t __wrap_nvs_write(struct nvs_fs *fs, uint16_t id, const void *data, size_t len)
{
    storage_fault_stage_t stage = STORAGE_FAULT_NONE;
    if (id == SETTINGS_INTENT_ID) { stage = STORAGE_FAULT_INTENT_WRITE; }
    else if (id == SETTINGS_COMMIT_ID) { stage = STORAGE_FAULT_COMMIT_WRITE; }
    else if (id == SETTINGS_META_ID) { stage = STORAGE_FAULT_META_WRITE; }
    else if (id >= SETTINGS_VALUE_FIRST && id < SETTINGS_VALUE_FIRST + SETTINGS_VALUE_COUNT) {
        stage = STORAGE_FAULT_VALUE_WRITE;
    }
    if (len && should_fail(fs, stage)) {
        return -EIO;
    }
    return __real_nvs_write(fs, id, data, len);
}

int __real_nvs_delete(struct nvs_fs *fs, uint16_t id);
int __wrap_nvs_delete(struct nvs_fs *fs, uint16_t id)
{
    storage_fault_stage_t stage = STORAGE_FAULT_NONE;
    if (id == SETTINGS_INTENT_ID) { stage = STORAGE_FAULT_INTENT_DELETE; }
    else if (id == SETTINGS_COMMIT_ID) { stage = STORAGE_FAULT_COMMIT_DELETE; }
    if (should_fail(fs, stage)) {
        return -EIO;
    }
    return __real_nvs_delete(fs, id);
}
```

## src/storage_fault.h
```c
#ifndef IDU_TEST_STORAGE_FAULT_H
#define IDU_TEST_STORAGE_FAULT_H

#include <zephyr/storage/flash_map.h>

typedef enum {
    STORAGE_FAULT_NONE,
    STORAGE_FAULT_MOUNT,
    STORAGE_FAULT_INTENT_WRITE,
    STORAGE_FAULT_COMMIT_WRITE,
    STORAGE_FAULT_VALUE_WRITE,
    STORAGE_FAULT_META_WRITE,
    STORAGE_FAULT_COMMIT_DELETE,
    STORAGE_FAULT_INTENT_DELETE,
} storage_fault_stage_t;

/* 仅拦截指定参数分区的外部 NVS 调用；每次 arm 只在选中步骤返回一次 EIO。 */
void storage_fault_reset(const struct flash_area *area);
void storage_fault_arm(storage_fault_stage_t stage);
/* 撤销注入前必须确认目标步骤命中过一次，未命中即使业务返回错误也失败。 */
void storage_fault_finish(void);

#endif
```
