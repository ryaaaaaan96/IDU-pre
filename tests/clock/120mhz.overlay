/* 仅编译的替代板级配置：8 MHz 晶振，PLL /2 *30，CPU 120 MHz。 */
&hxtal { clock-frequency = <8000000>; };
&pll {
    /delete-property/ hxtal-bypass;
    prediv = <2>;
    mul = <30>;
};
&cpu0 { clock-frequency = <120000000>; };
