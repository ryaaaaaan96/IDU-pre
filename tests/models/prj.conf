## CMakeLists.txt
```
cmake_minimum_required(VERSION 3.20.0)
get_filename_component(IDU_APP ${CMAKE_CURRENT_SOURCE_DIR}/../.. ABSOLUTE)
include(${IDU_APP}/modules/modules.cmake)
find_package(Zephyr REQUIRED HINTS $ENV{ZEPHYR_BASE})
project(idu_model_tests)
target_sources(app PRIVATE src/main.c)
```

## prj.conf
```kconfig
CONFIG_ZTEST=y
CONFIG_MODBUS=y
CONFIG_MODBUS_ROLE_CLIENT_SERVER=y
CONFIG_MODBUS_FP_EXTENSIONS=n
CONFIG_MODBUS_RAW_ADU=y
CONFIG_MODBUS_NUMOF_RAW_ADU=1
CONFIG_DATAPROCESS=y
CONFIG_CO_MAX_BUSES=2
CONFIG_DP_PROCESS=y
CONFIG_DP_PARAMS=n
CONFIG_ZBUS_PREFER_DYNAMIC_ALLOCATION=n
CONFIG_ZBUS_MSG_SUBSCRIBER_BUF_ALLOC_STATIC=y
CONFIG_ZBUS_MSG_SUBSCRIBER_NET_BUF_POOL_SIZE=2
CONFIG_ZBUS_MSG_SUBSCRIBER_NET_BUF_STATIC_DATA_SIZE=640
CONFIG_MAIN_STACK_SIZE=4096
CONFIG_TEST_EXTRA_STACK_SIZE=4096
CONFIG_SYSTEM_WORKQUEUE_STACK_SIZE=2048
CONFIG_NATIVE_SIM_SLOWDOWN_TO_REAL_TIME=n
```

## src/main.c
```c
#include "../../fixtures/dp_tasks.h"
#include "../../fixtures/point_connections.h"
#include "model_fixture.h"
#include <collect/collect.h>
#include <transmit/transmit.h>
#include <errno.h>
#include <string.h>
#include <zephyr/sys/byteorder.h>
#include <zephyr/ztest.h>

IDU_MVIO_COLLECT_FIELDS(peer);
static const struct dp_point_cfg points[] = {
    IDU_MVIO_POINTS(10, 2000, 15000),
    IDU_MVIO_POINTS(20, 2000, 15000),
};
static const struct dp_device_cfg devices[] = {
    {.dev_id = 10, .bus_id = 0, .unit_id = 1},
    {.dev_id = 20, .bus_id = 1, .unit_id = 1},
};
static const struct co_cfg collect[] = {
    IDU_MVIO_COLLECT(peer, 10, 500, 5000),
    IDU_MVIO_COLLECT(peer, 20, 750, 6000),
};
static const struct dp_transmit_cfg transmit[] = {
    IDU_MVIO_TRANSMIT(10, 10000, 30460),
    IDU_MVIO_TRANSMIT(20, 10100, 30462),
};
static const struct dp_equip_cfg cfg = {
    .points = points, .point_count = ARRAY_SIZE(points),
    .devices = devices, .device_count = ARRAY_SIZE(devices),
    .collect = collect, .collect_count = ARRAY_SIZE(collect),
    .transmit = transmit, .transmit_count = ARRAY_SIZE(transmit),
};

struct peer_state {
    uint16_t value;
    int error;
};
static struct peer_state peers[] = {{.value = 17}, {.value = 29}};

static int transfer(void *user, uint16_t dev_id, struct modbus_adu *adu,
                     k_timeout_t timeout)
{
    ARG_UNUSED(timeout);
    ARG_UNUSED(dev_id);
    struct peer_state *peer_state = user;
    zassert_equal(adu->unit_id, 1);
    zassert_equal(adu->length, 4);
    uint16_t address = sys_get_be16(adu->data);
    uint16_t count = sys_get_be16(adu->data + 2);
    if (peer_state->error) { return peer_state->error; }
    zassert_true(count <= 8);
    if (address == 30459) { zassert_equal(adu->fc, 3); }
    else { zassert_equal(adu->fc, 4); }
    adu->length = 1 + count * 2;
    adu->data[0] = count * 2;
    for (size_t i = 0; i < count; ++i) {
        sys_put_be16(peer_state->value + i, adu->data + 1 + 2 * i);
    }
    return 0;
}

static void *setup(void)
{
    zassert_ok(dp_init_config(&cfg)); fixture_start_dp();
    for (size_t i = 0; i < ARRAY_SIZE(peers); ++i) {
        struct co_bus_cfg bus = {
            .id = i, .iface = -1, .simulated = i == 0,
            .transfer = transfer, .user = &peers[i],
        };
        fixture_connect_points();
        zassert_ok(co_init_bus(&cfg, &bus));
    }
    return NULL;
}

static void poll_and_wait(size_t block, int expected)
{
    struct dp_key key = {collect[block].dev_id, collect[block].fields[0].sig_id};
    struct dp_point_state state;
    zassert_ok(dp_read(key, &state));
    uint32_t old = state.generation;
    zassert_equal(co_poll(block), expected);
    for (size_t attempt = 0; attempt < 100; ++attempt) {
        zassert_ok(dp_read(key, &state));
        if (state.generation != old) { return; }
        k_msleep(1);
    }
    zassert_unreachable("model collection was not consumed");
}

ZTEST(models, test_instances_share_fields_and_keep_independent_windows)
{
    zassert_equal(cfg.point_count, 22);
    zassert_equal(cfg.collect_count, 8);
    zassert_equal(cfg.transmit_count, 44);
    zassert_equal(collect[0].fields, collect[4].fields);
    zassert_equal(collect[1].fields, collect[5].fields);
    poll_and_wait(0, 0);
    poll_and_wait(4, 0);
    uint16_t first, second;
    zassert_ok(tr_read(0, 4, 10000, &first, 1));
    zassert_ok(tr_read(0, 4, 10100, &second, 1));
    zassert_equal(first, 17);
    zassert_equal(second, 29);
    zassert_ok(tr_read(0, 4, 10009, &first, 1));
    zassert_ok(tr_read(0, 4, 10109, &second, 1));
    zassert_equal(first, DP_QUALITY_GOOD | DP_QUALITY_SIMULATED);
    zassert_equal(second, DP_QUALITY_GOOD);
}

ZTEST(models, test_collect_process_transmit_widths_and_addresses)
{
    poll_and_wait(1, 0);
    poll_and_wait(2, 0);
    poll_and_wait(3, 0);
    uint16_t words[8];
    zassert_ok(tr_read(0, 4, 10001, words, 8));
    for (size_t i = 0; i < 8; ++i) { zassert_equal(words[i], 17 + i); }
    zassert_ok(tr_read(0, 4, 10010, words, 2));
    zassert_equal(words[0], 17);
    zassert_equal(words[1], 18);
    zassert_ok(tr_read(0, 3, 30460, words, 1));
    zassert_equal(words[0], 17);
    zassert_equal(tr_read(0, 4, 10012, words, 1), -ENOENT);
    zassert_equal(tr_read(0, 4, 10023, words, 2), -ENOENT);
}

ZTEST(models, test_transport_failure_does_not_poison_other_instance)
{
    poll_and_wait(0, 0);
    poll_and_wait(4, 0);
    peers[0].error = -ETIMEDOUT;
    poll_and_wait(0, -ETIMEDOUT);
    peers[0].error = 0;
    uint16_t value;
    zassert_equal(tr_read(0, 4, 10000, &value, 1), -ENOTSUP);
    zassert_ok(tr_read(0, 4, 10009, &value, 1));
    zassert_equal(value, DP_QUALITY_COMM_ERROR | DP_QUALITY_SIMULATED);
    zassert_ok(tr_read(0, 4, 10100, &value, 1));
    zassert_equal(value, 29);
    poll_and_wait(0, 0);
    zassert_ok(tr_read(0, 4, 10000, &value, 1));
    zassert_equal(value, 17);
}

ZTEST(models, test_instance_conflicts_are_rejected_before_start)
{
    struct dp_equip_cfg invalid = cfg;
    struct dp_device_cfg changed_devices[ARRAY_SIZE(devices)];
    memcpy(changed_devices, devices, sizeof(devices));
    invalid.devices = changed_devices;
    changed_devices[1].dev_id = 10;
    zassert_equal(dp_validate(&invalid), -EEXIST);
    changed_devices[1] = devices[1];
    changed_devices[1].bus_id = 0;
    zassert_equal(dp_validate(&invalid), -EEXIST);

    struct dp_transmit_cfg changed_maps[ARRAY_SIZE(transmit)];
    memcpy(changed_maps, transmit, sizeof(transmit));
    invalid = cfg;
    invalid.transmit = changed_maps;
    changed_maps[22].address = 10000;
    zassert_equal(dp_validate(&invalid), -EEXIST);
    changed_maps[22] = transmit[22];
    changed_maps[22].key.dev_id = 30;
    zassert_equal(dp_validate(&invalid), -EINVAL);
}

ZTEST_SUITE(models, NULL, setup, NULL, NULL, NULL);
```

## src/model_fixture.h
```c
#ifndef TEST_MVIO_MODEL_H
#define TEST_MVIO_MODEL_H

#include <collect/collect.h>

/* 可复用的南向 MV-IO 模型。
 * 逻辑设备 ID 与总线、站号、北向地址基址分别绑定。
 * 展开后生成 Flash 常量表，各实例共用不可变采集字段数组。
 * 下方寄存器号描述南向协议，不描述本地 BSP。
 */
typedef enum {
    IDU_MVIO_DI = 8152,
    IDU_MVIO_CURRENT_1 = 8163,
    IDU_MVIO_PROTOCOL = 8150,
    IDU_MVIO_ADDRESS = 30459,
} idu_mvio_signal_t;

/* 处理测点定义。 */
/* 共享 MV-IO 信号定义，每个逻辑设备展开一次。
 */
#define IDU_MVIO_CURRENT_POINT(dev, n, stale) \
    {.key = {dev, IDU_MVIO_CURRENT_1 + (n)}, .source = DP_SOURCE_MODBUS, \
     .type = DP_U16, .width = 1, .maximum = UINT16_MAX, .stale_ms = stale}

#define IDU_MVIO_POINTS(dev, sample_stale, identity_stale) \
    {.key = {dev, IDU_MVIO_DI}, .source = DP_SOURCE_MODBUS, \
     .type = DP_U16, .width = 1, .maximum = UINT16_MAX, .stale_ms = sample_stale}, \
    IDU_MVIO_CURRENT_POINT(dev, 0, sample_stale), \
    IDU_MVIO_CURRENT_POINT(dev, 1, sample_stale), \
    IDU_MVIO_CURRENT_POINT(dev, 2, sample_stale), \
    IDU_MVIO_CURRENT_POINT(dev, 3, sample_stale), \
    IDU_MVIO_CURRENT_POINT(dev, 4, sample_stale), \
    IDU_MVIO_CURRENT_POINT(dev, 5, sample_stale), \
    IDU_MVIO_CURRENT_POINT(dev, 6, sample_stale), \
    IDU_MVIO_CURRENT_POINT(dev, 7, sample_stale), \
    {.key = {dev, IDU_MVIO_PROTOCOL}, .source = DP_SOURCE_MODBUS, \
     .type = DP_U32, .width = 2, .maximum = UINT32_MAX, .stale_ms = identity_stale}, \
    {.key = {dev, IDU_MVIO_ADDRESS}, .source = DP_SOURCE_MODBUS, \
     .type = DP_U16, .width = 1, .minimum = 1, .maximum = 247, \
     .stale_ms = identity_stale}

/* 采集字段和报文块。 */
/* 共享 MV-IO 通信字段和轮询块，设备与周期分别绑定。
 */
#define IDU_MVIO_CURRENT_FIELD(n) \
    {.sig_id = IDU_MVIO_CURRENT_1 + (n), .offset = n, .width = 1}

/* 在采集编译单元中声明一次，供多个实例复用。 */
#define IDU_MVIO_COLLECT_FIELDS(name) \
    static const struct co_field name##_di[] = { \
        {.sig_id = IDU_MVIO_DI, .width = 1}, \
    }; \
    static const struct co_field name##_currents[] = { \
        IDU_MVIO_CURRENT_FIELD(0), IDU_MVIO_CURRENT_FIELD(1), \
        IDU_MVIO_CURRENT_FIELD(2), IDU_MVIO_CURRENT_FIELD(3), \
        IDU_MVIO_CURRENT_FIELD(4), IDU_MVIO_CURRENT_FIELD(5), \
        IDU_MVIO_CURRENT_FIELD(6), IDU_MVIO_CURRENT_FIELD(7), \
    }; \
    static const struct co_field name##_protocol[] = { \
        {.sig_id = IDU_MVIO_PROTOCOL, .width = 2, .order = DP_LOW_WORD_FIRST}, \
    }; \
    static const struct co_field name##_address[] = { \
        {.sig_id = IDU_MVIO_ADDRESS, .width = 1}, \
    }

#define IDU_MVIO_COLLECT(name, dev, sample_period, identity_period) \
    {.dev_id = dev, .function = 4, .address = 8152, .count = 1, \
     .period_ms = sample_period, .fields = name##_di, \
     .field_count = ARRAY_SIZE(name##_di)}, \
    {.dev_id = dev, .function = 4, .address = 8163, .count = 8, \
     .period_ms = sample_period, .fields = name##_currents, \
     .field_count = ARRAY_SIZE(name##_currents)}, \
    {.dev_id = dev, .function = 4, .address = 8150, .count = 2, \
     .period_ms = identity_period, .fields = name##_protocol, \
     .field_count = ARRAY_SIZE(name##_protocol)}, \
    {.dev_id = dev, .function = 3, .address = 30459, .count = 1, \
     .period_ms = identity_period, .fields = name##_address, \
     .field_count = ARRAY_SIZE(name##_address)}

/* 北向数值与质量映射。 */
/* MV-IO 北向数值与质量映射，地址窗口分别绑定。
 */
#define IDU_MVIO_MAP(dev, base, offset, sig, words) \
    {.function = 4, .address = (base) + (offset), .count = words, .key = {dev, sig}}
#define IDU_MVIO_QUALITY(dev, base, offset, sig) \
    {.function = 4, .address = (base) + (offset), .count = 1, \
     .key = {dev, sig}, .kind = DP_MAP_QUALITY}
#define IDU_MVIO_TRANSMIT_CURRENT(dev, base, n) \
    IDU_MVIO_MAP(dev, base, 1 + (n), IDU_MVIO_CURRENT_1 + (n), 1)
#define IDU_MVIO_TRANSMIT_QUALITY(dev, base, n) \
    IDU_MVIO_QUALITY(dev, base, 14 + (n), IDU_MVIO_CURRENT_1 + (n))

/* Base+12/+13 留给应用使用；
 * address_reg 属于独立 FC03 窗口，
 * 参数写映射由应用配置定义。
 */
#define IDU_MVIO_TRANSMIT(dev, base, address_reg) \
    IDU_MVIO_MAP(dev, base, 0, IDU_MVIO_DI, 1), \
    IDU_MVIO_TRANSMIT_CURRENT(dev, base, 0), \
    IDU_MVIO_TRANSMIT_CURRENT(dev, base, 1), \
    IDU_MVIO_TRANSMIT_CURRENT(dev, base, 2), \
    IDU_MVIO_TRANSMIT_CURRENT(dev, base, 3), \
    IDU_MVIO_TRANSMIT_CURRENT(dev, base, 4), \
    IDU_MVIO_TRANSMIT_CURRENT(dev, base, 5), \
    IDU_MVIO_TRANSMIT_CURRENT(dev, base, 6), \
    IDU_MVIO_TRANSMIT_CURRENT(dev, base, 7), \
    IDU_MVIO_QUALITY(dev, base, 9, IDU_MVIO_DI), \
    IDU_MVIO_MAP(dev, base, 10, IDU_MVIO_PROTOCOL, 2), \
    IDU_MVIO_TRANSMIT_QUALITY(dev, base, 0), \
    IDU_MVIO_TRANSMIT_QUALITY(dev, base, 1), \
    IDU_MVIO_TRANSMIT_QUALITY(dev, base, 2), \
    IDU_MVIO_TRANSMIT_QUALITY(dev, base, 3), \
    IDU_MVIO_TRANSMIT_QUALITY(dev, base, 4), \
    IDU_MVIO_TRANSMIT_QUALITY(dev, base, 5), \
    IDU_MVIO_TRANSMIT_QUALITY(dev, base, 6), \
    IDU_MVIO_TRANSMIT_QUALITY(dev, base, 7), \
    IDU_MVIO_QUALITY(dev, base, 22, IDU_MVIO_PROTOCOL), \
    IDU_MVIO_QUALITY(dev, base, 23, IDU_MVIO_ADDRESS), \
    {.function = 3, .address = address_reg, .count = 1, .key = {dev, IDU_MVIO_ADDRESS}}

#endif
```
