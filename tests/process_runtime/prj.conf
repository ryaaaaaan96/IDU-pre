## CMakeLists.txt
```
cmake_minimum_required(VERSION 3.20.0)
get_filename_component(IDU_APP ${CMAKE_CURRENT_SOURCE_DIR}/../.. ABSOLUTE)
include(${IDU_APP}/modules/modules.cmake)
find_package(Zephyr REQUIRED HINTS $ENV{ZEPHYR_BASE})
project(process_runtime_tests)
target_include_directories(app PRIVATE ${IDU_APP}/app ${IDU_APP}/app/protocol/inc)
target_sources(app PRIVATE src/main.c
  ${IDU_APP}/app/protocol/process_runtime.c
  ${IDU_APP}/app/protocol/tables/process.c
  ${IDU_APP}/app/process/points.c)
```

## Kconfig
```
mainmenu "Process runtime tests"
source "Kconfig.zephyr"
rsource "../../app/Kconfig"
```

## prj.conf
```kconfig
CONFIG_ZTEST=y
CONFIG_DATAPROCESS=y
CONFIG_MAIN_STACK_SIZE=4096
CONFIG_TEST_EXTRA_STACK_SIZE=4096
CONFIG_SYSTEM_WORKQUEUE_STACK_SIZE=2048
CONFIG_NATIVE_SIM_SLOWDOWN_TO_REAL_TIME=n
CONFIG_IDU_SAMPLE_PERIOD_MS=500
```

## src/main.c
```c
#include "protocol/inc/protocol.h"
#include "protocol/inc/process_table.h"
#include "protocol/inc/signal_keys.h"
#include <dataprocess/dataprocess.h>
#include <errno.h>
#include <string.h>
#include <zephyr/ztest.h>

ZTEST(process_runtime, test_local_process_without_communication)
{
    zassert_equal(protocol_local_table.point_count, PROCESS_SIGNAL_COUNT);
    zassert_equal(protocol_local_table.points[PROCESS_DI].signal_key, SIGNAL_DI);
    zassert_equal(
        protocol_local_table.points[PROCESS_SAMPLE_PERIOD].signal_key, SIGNAL_SAMPLE_PERIOD);
    zassert_equal(protocol_local_table.points[PROCESS_CURRENT_8].signal_key, SIGNAL_CURRENT_8);
    zassert_ok(protocol_init());

    const value_t value = {.u16 = 0x55aa};
    value_t result;
    zassert_ok(dp_set_para(DEVICE_LOCAL, SIGNAL_DI, &value));
    zassert_ok(dp_get_para(DEVICE_LOCAL, SIGNAL_DI, &result));
    zassert_equal(result.u16, value.u16);

    value_t period;
    zassert_ok(dp_get_para(DEVICE_LOCAL, SIGNAL_SAMPLE_PERIOD, &period));
    zassert_equal(period.u16, CONFIG_IDU_SAMPLE_PERIOD_MS);

    zassert_equal(protocol_init(), -EEXIST);
}

ZTEST_SUITE(process_runtime, NULL, NULL, NULL, NULL, NULL);
```
