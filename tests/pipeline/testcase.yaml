## tests/pipeline/testcase.yaml
```yaml
tests:
  idu.pipeline.telemetry:
    platform_allow: native_sim/native/64
    integration_platforms:
      - native_sim/native/64
    tags:
      - modbus
      - zbus
      - idu
  idu.pipeline.telemetry_without_adapter:
    platform_allow: native_sim/native/64
    integration_platforms:
      - native_sim/native/64
    extra_args: EXTRA_CONF_FILE=adapter-off.conf
    tags:
      - modbus
      - zbus
      - idu
  idu.pipeline.basic_points:
    platform_allow: native_sim/native/64
    integration_platforms:
      - native_sim/native/64
    extra_args: EXTRA_CONF_FILE=process-off.conf
    tags:
      - modbus
      - zbus
      - idu
```

## tests/point_parameters/testcase.yaml
```yaml
tests:
  idu.point_parameters.common:
    platform_allow: native_sim/native/64
    tags: [dataprocess, flash]
  idu.point_parameters.country:
    platform_allow: native_sim/native/64
    extra_args:
      - EXTRA_CONF_FILE=country.conf
    tags: [dataprocess, flash]
```

## tests/points/testcase.yaml
```yaml
tests:
  idu.points.pipeline:
    platform_allow: native_sim/native/64
    integration_platforms:
      - native_sim/native/64
    tags:
      - modbus
      - zbus
      - idu
```

## tests/reference_config/testcase.yaml
```yaml
tests:
  idu.reference_configuration:
    platform_allow: native_sim/native/64
    tags: [dataprocess, reference]
```

## tests/reference_dp/testcase.yaml
```yaml
tests:
  idu.reference_dp:
    platform_allow: native_sim/native/64
    tags: dataprocess
  idu.reference_dp.store_only:
    platform_allow: native_sim/native/64
    extra_args: EXTRA_CONF_FILE=process_off.conf
    tags: dataprocess
```

## tests/reference_services/testcase.yaml
```yaml
tests:
  idu.reference_services:
    platform_allow: native_sim/native/64
    integration_platforms: [native_sim/native/64]
  idu.reference_services.params:
    platform_allow: native_sim/native/64
    integration_platforms: [native_sim/native/64]
    extra_args: EXTRA_CONF_FILE=params.conf
```

## tests/runtime/testcase.yaml
```yaml
tests:
  idu.runtime.fault:
    platform_allow: native_sim/native/64
    tags: [idu, runtime]
    harness: console
    harness_config:
      type: one_line
      regex:
        - "RUNTIME_RESET_PASS"
```

## tests/simulator/testcase.yaml
```yaml
tests:
  collect.simulator:
    platform_allow: native_sim/native/64
    tags: modbus collect
```

## tests/transmit_port/testcase.yaml
```yaml
tests:
  idu.transmit_port:
    platform_allow: native_sim/native/64
    tags:
      - modbus
      - vport
```

## tests/vport/testcase.yaml
```yaml
tests:
  modules.vport:
    platform_allow: native_sim/native/64
    tags: [vport, communication]
```
