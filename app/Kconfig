## app/Kconfig
```kconfig
rsource "status/Kconfig"

config IDU_SAMPLE_PERIOD_MS
    int "Acquisition period in milliseconds"
    default 500
    range 100 1000

config IDU_ADC_AVERAGE_COUNT
    int "Samples averaged per product analog input"
    depends on ADC
    default 10
    range 1 64

config IDU_IAPV3
    bool "MV-IO IAPv3 AES/SGZ receiver"
    depends on BOOTLOADER_MCUBOOT && !MCUMGR_GRP_IMG
```

## app/iap/Kconfig
```kconfig
config IDU_IAPV3
    bool "MV-IO IAPv3 AES/SGZ receiver"
    depends on BOOTLOADER_MCUBOOT && !IDU_AIDC_PROFILE && !MCUMGR_GRP_IMG
    depends on IAP_CONFIGURED && IAP_REBOOT_DP_PARAMS && TR_MODBUS_ADAPTER
    help
      Alternative to SMP image upload on the fitted MV-IO RS485 port.
      Accepts a single ARM QuickLZ level-3 SGZ containing a signed MCUboot
      ECDSA-P256 image. Delta and downstream-device upgrades are unsupported.
```

## boards/idu/idu_pre/board.yml
```yaml
board:
  name: idu_pre
  full_name: IDU-pre MV-IO GD32E505
  vendor: others
  socs:
    - name: gd32e505
```

## cfg/Kconfig
```kconfig
choice IDU_COLLECT_BACKEND
    prompt "Acquisition Modbus transport"
    default IDU_COLLECT_VIRTUAL

config IDU_COLLECT_VIRTUAL
    bool "Virtual Modbus ADU loopback (demo device)"
    select MODBUS_RAW_ADU

config IDU_COLLECT_RTU
    bool "Physical Modbus RTU via idu-collect DT alias"
    depends on MODBUS_SERIAL

endchoice

config MODBUS_NUMOF_RAW_ADU
    default 2 if IDU_COLLECT_VIRTUAL

config IDU_SAMPLE_PERIOD_MS
    int "Acquisition period in milliseconds"
    default 500
    range 100 1000


config IDU_AIDC_PROFILE
    bool "Imported AIDC business tables with virtual UPP acquisition"
    depends on IDU_COLLECT_VIRTUAL
    help
      Preserves original IDs, point types/defaults and register addresses.
      Hardware-only product services remain explicitly unavailable.

config IDU_AIDC_VIRTUAL_PERIOD_MS
    int "Virtual UPP sampling period (not a decoded legacy cycle code)"
    depends on IDU_AIDC_PROFILE
    default 1000
    range 100 60000
```

## modules/analog_input/Kconfig
```kconfig
config ANALOG_INPUT
    bool "Configured ADC channel groups with software averaging"
    depends on ADC
```

## modules/analog_io/Kconfig
```kconfig
config ANALOG_IO
    bool "Configured ADC channel groups with software averaging"
    depends on ADC
```

## modules/collect/Kconfig
```kconfig
menuconfig COLLECT
    bool "Equipment acquisition and bus scheduling"
    depends on DATAPROCESS && MODBUS
    default y if MODBUS_CLIENT

if COLLECT

config CO_EXCHANGE_TIMEOUT_MS
    int "Total budget per southbound message exchange (ms)"
    default 500
    range 10 10000
    help
      Includes bus and transport ownership, sending and the response wait.
      Each automatic retry receives a new budget. Backend callbacks must honor
      their supplied remaining timeout; contention before sending is EBUSY.

config HEAP_MEM_POOL_ADD_SIZE_COLLECT
    int "Shared heap budget for acquisition queues and message buffers (bytes)"
    default 12288
    range 1024 131072
    help
      Covers queued/active request copies and concurrent temporary ADUs,
      sample batches and RAW frames. Tune for bus count, queue depth and
      MODBUS_BUFFER_SIZE. Allocation failures return ENOMEM without sending.

config CO_MAX_BUSES
    int "Maximum acquisition buses"
    default 1
    range 1 8
    help
      Number of statically reserved bus states and request queues.
      Bus IDs must be in the range 0 to CO_MAX_BUSES - 1. Only registered buses
      may be run by application-owned workers. Stacks are supplied by the
      application; all configured state/queue slots reserve RAM.

config CO_QUEUE_DEPTH
    int "Maximum queued requests per acquisition bus"
    default 4
    range 1 16

config CO_STACK_SIZE
    int "Stack size per acquisition bus (bytes)"
    default 4096
    range 1024 65536
    help
      Stack size used by applications creating a bus worker, including
      acquisition backend callbacks. The application declares stacks only for
      its configured execution contexts; collect does not allocate stacks.
      Size this for the complete backend call chain. In particular, large
      MODBUS_BUFFER_SIZE values increase stack-local ADU and RAW frame buffers;
      the default does not guarantee enough space for every transport setup.

config CO_VPORT
    bool "Complete-message ports through vport"
    select VPORT

rsource "protocols/modbus/Kconfig"

config CO_MODEL_SIMULATOR
    bool "Reference model default-value simulator"
    depends on DP_REFERENCE_TABLES

endif
```

## modules/collect/protocols/modbus/Kconfig
```kconfig
menuconfig CO_MODBUS_ADAPTER
    bool "Zephyr Modbus client adapter"
    depends on MODBUS_CLIENT
    default y
    help
      Enable the built-in RTU/RAW client and port configuration. No transmit
      service is required. Disable for buses supplying their own transfer or
      read_model callbacks; the existing ADU data contract is retained.

config CO_TIMEOUT_MS
    int "Modbus acquisition response timeout (ms)"
    depends on CO_MODBUS_ADAPTER
    default 100
    range 10 1000

config CO_SIMULATOR
    bool "Configured Modbus ADU device simulator"
    depends on CO_MODBUS_ADAPTER && MODBUS_RAW_ADU && TR_MODBUS_ADAPTER

config CO_SIMULATOR_WORDS
    int "Words per simulated register bank"
    depends on CO_SIMULATOR
    default 32
    range 1 256

config CO_MODBUS_RAW_PORT
    bool "Modbus RAW complete-message port adapter"
    depends on CO_MODBUS_ADAPTER && MODBUS_RAW_ADU
    depends on !MODBUS_SERIAL_ASYNC_API
    select CO_VPORT

config CO_MODBUS_TX_TIMEOUT_MS
    int "Complete-message send timeout (ms)"
    depends on CO_MODBUS_RAW_PORT
    default 3000
    range 10 10000
```

## modules/common/Kconfig
```kconfig
config COMMON_VALUE_WORDS
    int "Maximum words in a shared value"
    default 16
    range 2 72
```

## modules/dataprocess/Kconfig
```kconfig
menuconfig DATAPROCESS
    bool "Point tables and synchronous RAM values"
    select KERNEL_MEM_POOL
    select SYS_HASH_MAP
    select SYS_HASH_MAP_OA_LP
    select SYS_HASH_FUNC32

if DATAPROCESS

config DP_HASH_LOOKUP
    bool "Use hashmap index for device lookup"
    default n
    help
      Keep a device_id-to-table index in RAM for average O(1) device lookup.
      Disabled uses linear device lookup. Signals within a device always
      use linear lookup. Includes additional buckets and resize memory.
      Both modes preserve point-table row order. Device traversal order
      is unspecified.

config HEAP_MEM_POOL_ADD_SIZE_DATAPROCESS
    int "System heap budget for registered devices and point data (bytes)"
    default 2048
    range 256 65536
    help
      Each device registration allocates one private node with its point data.
      Include the node, point_count times sizeof(dp_point_data_t), and heap overhead.
      Registration uses a temporary hashmap for duplicate keys. Include its
      bucket allocation and resize peak in addition to previously registered data.

endif
```

## modules/gd32e505/Kconfig
```kconfig
config ADC_GD32E50X
    bool "GD32E50x synchronous ADC driver"
    default y
    depends on ADC && SOC_GD32E505
    depends on DT_HAS_GD_GD32E50X_ADC_ENABLED
    select PINCTRL
    select RESET
    select USE_GD32_ADC
    help
      Bounded polling driver for ADC0 external channels. Supports single-channel
      synchronous reads, 6/8/10/12-bit resolution and explicit calibration.
      DMA, asynchronous reads, sequence options and oversampling are unsupported.
```

## modules/gd32e505/dts/bindings/adc/gd,gd32e50x-adc.yaml
```yaml
description: |
  GD32E50x ADC0, external channels 0 to 15. Polling conversions use bounded
  waits and support the Zephyr synchronous ADC API. The prescaler is shared
  across the ADC block; additional ADC instances are not supported yet.
compatible: "gd,gd32e50x-adc"
include: [adc-controller.yaml, reset-device.yaml, pinctrl-device.yaml]
properties:
  reg:
    required: true
  clocks:
    required: true
  resets:
    required: true
  clock-prescaler:
    type: int
    required: true
    enum: [2, 4, 6, 8, 12, 16]
  vdda-millivolts:
    type: int
    required: true
    description: Analog supply used to validate the ADC clock limit.
  "#io-channel-cells":
    const: 1
  pinctrl-0:
    required: true
  pinctrl-names:
    required: true
io-channel-cells:
  - input
```

## modules/gd32e505/dts/bindings/clock/gd,gd32e505-pll.yaml
```yaml
description: |
  GD32E505 HXTAL PLL startup configuration. AHB runs at the PLL output rate.
  The board supplies its oscillator, bypass mode, PLL factors and APB divisors.
compatible: "gd,gd32e505-pll"
include: base.yaml
properties:
  clocks:
    required: true
  "#clock-cells":
    type: int
    const: 0
  hxtal-bypass:
    type: boolean
    description: Use an external active clock instead of a crystal.
  prediv:
    type: int
    required: true
    enum: [1, 2, 3, 4, 5, 6, 7, 8, 9, 10, 11, 12, 13, 14, 15, 16]
    description: CL PREDV0 divider, configured in RCU_CFG1.
  mul:
    type: int
    required: true
    description: Integer PLL multiplier from 2 to 63.
  apb1-prescaler:
    type: int
    required: true
    enum: [1, 2, 4, 8, 16]
  apb2-prescaler:
    type: int
    required: true
    enum: [1, 2, 4, 8, 16]
```

## modules/health_monitor/Kconfig
```kconfig
config HEALTH_MONITOR
    bool "Progress-gated external GPIO watchdog"
    depends on GPIO
```

## modules/iap/Kconfig
```kconfig
# 模块先于子系统默认值加载，第一个匹配的范围生效。
config MODBUS_BUFFER_SIZE
    range 64 1100 if IAP

menuconfig IAP
    bool "Legacy IAPv3 receiver with signed MCUboot images"
    depends on MODBUS && !MCUMGR_GRP_IMG
    depends on IMG_MANAGER && MCUBOOT_IMG_MANAGER && IMG_ERASE_PROGRESSIVELY
    depends on STREAM_FLASH && FLASH_MAP && FLASH_PAGE_LAYOUT && NVS && REBOOT
    depends on UPDATEABLE_IMAGE_NUMBER = 1
    depends on !BOOTLOADER_MCUBOOT || MCUBOOT_BOOTLOADER_MODE_SWAP_SCRATCH
    select QUICKLZ
    select KERNEL_MEM_POOL
    help
      Single ARM SGZ/QuickLZ level-3 image over legacy Modbus IAPv3, with
      ECDSA-P256 verification, flash staging and a durable result journal.
      Supply partition IDs, keys, memory ranges and reboot hooks at startup.
      Requires a whole-ADU router accepting oversized packets; no DP or
      transmit module is required. Native tests can emulate MCUboot.

if IAP

config HEAP_MEM_POOL_ADD_SIZE_IAP
    int "Shared heap budget for IAP receiver working storage (bytes)"
    default 16384
    range 8192 65536
    help
      Allocated once at initialization for packet/erase bitmaps, the packet,
      SGZ workspace and flash writer. Tune for IAP_MAX_CONTAINER_SIZE and
      flash writer buffering. Failed initialization releases flash areas.

config IAP_CONFIGURED
    bool "Configure IAP from devicetree and Kconfig"
    default y
    help
      iap_init() reads iap,staging and iap,journal chosen partitions,
      slot0_partition's mapped address and zephyr,sram. Keys and image
      payload limits come from the options below. Disable when calling
      iap_init_config() with an explicit configuration (for example in tests).

if IAP_CONFIGURED

config IAP_IMAGE_MAX_SIZE
    hex "Maximum signed image bytes (reserve MCUboot trailer space)"
    default 0x6e000
    range 0x220 0xffffff

config IAP_PUBLIC_KEY_FILE
    string "MCUboot P-256 verification PEM file"
    default MCUBOOT_SIGNATURE_KEY_FILE
    help
      Public PEM or the same signing PEM used by MCUboot. Only public
      verification material is emitted into the firmware. Relative paths
      are resolved against the application configuration directory.

config IAP_AES_KEY_HEX
    string "Legacy AES-128 transport key (32 hexadecimal characters)"
    default ""
    help
      Interoperability key for the old host tool. It does not authenticate
      firmware; MCUboot ECDSA-P256 remains mandatory.



endif

config IAP_MAX_CONTAINER_SIZE
    int "Maximum SGZ staging capacity in bytes"
    default 983040
    range 4096 1048560
    help
      Bounds heap-allocated packet/erase bitmaps. Actual transfers are limited by
      the configured staging partition, which may be smaller. The legacy
      16-bit packet count supports at most 65535 packets of 16 bytes.

endif
```

## modules/idu_points/Kconfig
```kconfig
menuconfig IDU_POINTS
    bool "IDU equipment point tables"
    depends on MODBUS_CLIENT && MODBUS_SERVER
    select ZBUS
    select ZBUS_MSG_SUBSCRIBER
    select ZBUS_MSG_SUBSCRIBER_NET_BUF_POOL_ISOLATION

if IDU_POINTS

config IDU_POINT_WORDS
    int "Maximum words in one point"
    default 16
    range 2 72

config IDU_PROCESS_MAX_OUTPUTS
    int "Maximum points produced by one process transaction"
    default 24
    range 4 64

config IDU_PROCESS_QUEUE_DEPTH
    int "Asynchronous process queue depth"
    default 4
    range 1 16

config IDU_PROCESS_TIMERS
    int "Registered business timers"
    default 8
    range 1 32

config IDU_BUS_COUNT
    int "Maximum acquisition buses"
    default 2
    range 1 8

config IDU_DEVICE_COUNT
    int "Maximum acquisition devices"
    default 16
    range 1 64

config IDU_PARAMS
    bool "Transactional parameter writes and durable NVS snapshots"
    depends on FLASH && FLASH_PAGE_LAYOUT && FLASH_MAP
    select NVS
    select NVS_DATA_CRC
    select REBOOT

config IDU_PARAMS_SNAPSHOT_BYTES
    int "Maximum encoded parameter snapshot bytes"
    default 2048
    range 256 8192
    depends on IDU_PARAMS

config IDU_PARAMS_MAX_COUNT
    int "Maximum parameter points"
    default 16
    range 1 192
    depends on IDU_PARAMS

config IDU_FORWARD_STACK_SIZE
    int "Isolated Modbus forwarding workqueue stack"
    default 4096
    depends on IDU_PARAMS

config IDU_FORWARD_PORTS
    int "Independent forwarding workqueues"
    default 2
    range 1 4
    depends on IDU_PARAMS

config IDU_POINTS_QUEUE_DEPTH
    int "Maximum pending acquisition batches"
    default 6
    range 1 16

config IDU_POINTS_MAX_POINTS
    int "Maximum configured signals"
    default 64
    range 16 768

config IDU_POINTS_VALUE_WORDS
    int "Total words reserved for configured point values"
    default 512
    range 64 16384
    help
      Sum of point widths, validated at startup. Each point uses its actual
      width; a short integer does not reserve a maximum-size string buffer.

config IDU_POINTS_MAX_POLLS
    int "Maximum collection blocks"
    default 16
    range 1 512

config IDU_POINTS_STACK_SIZE
    int "Point processor stack size"
    default 4096

config IDU_COLLECT_STACK_SIZE
    int "Modbus collector stack size"
    default 4096

config IDU_COLLECT_TIMEOUT_MS
    int "Modbus acquisition response timeout (ms)"
    default 100
    range 10 1000

endif
```

## modules/input_sampler/Kconfig
```kconfig
config INPUT_SAMPLER
    bool "Configured analog and digital input sampling"
    depends on ADC && GPIO
    select ANALOG_INPUT
    select DIGITAL_IO
    help
      Combine caller-provided analog and digital input groups into one sampling
      operation. Hardware selection and application interpretation stay with
      the caller. No product devicetree node or channel count is assumed.
```

## modules/led_indicator/Kconfig
```kconfig
config LED_INDICATOR
    bool "LED indication with software blink timing"
    depends on LED
```

## modules/modbus/Kconfig
```kconfig
config MODBUS_SUPPORT
    bool "Zephyr Modbus shared transport support"
    depends on MODBUS
    help
      Shared RTU conversion and reviewed build-local Zephyr Modbus fixes.
      Does not create workers or register application routing.

config MODBUS_SUPPORT_SERVER_HOOKS
    bool
    depends on MODBUS_SUPPORT
    help
      Internal contract selected by the forwarding adapter. The selecting
      adapter supplies request routing and execution hooks; otherwise the
      shared compatibility code uses Zephyr's ordinary handling.
```
