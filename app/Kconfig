## app/Kconfig
```kconfig
rsource "status/Kconfig"

config IDU_ACQUISITION_STACK_SIZE
    int "Acquisition thread stack size"
    default 4096
    range 2048 16384

config IDU_IAPV3
    bool "MV-IO IAPv3 AES/SGZ receiver"
    depends on BOOTLOADER_MCUBOOT && !MCUMGR_GRP_IMG
```

## boards/idu/idu_pre/board.yml
```yaml
board:
  name: idu_pre
  full_name: IDU-Transformer MV-IO GD32E505
  vendor: others
  socs:
    - name: gd32e505
```

## modules/dataprocess/Kconfig
```kconfig
menuconfig DATAPROCESS
    bool "Point tables and deferred NVS parameters"
    select KERNEL_MEM_POOL
    select SYS_HASH_MAP
    select SYS_HASH_MAP_OA_LP
    select SYS_HASH_FUNC32
    select REBOOT
    select FLASH
    select FLASH_MAP
    select FLASH_PAGE_LAYOUT
    select NVS
    select NVS_DATA_CRC
    select NVS_LOOKUP_CACHE

if DATAPROCESS

config DP_HASH_LOOKUP
    bool "Use hashmap index for device lookup"
    default n
    help
      Keep a device_id-to-table index in RAM for average O(1) device lookup.
      Disabled uses linear device lookup. Signals within a device always
      use linear lookup. Includes additional buckets and resize memory.
      Both modes preserve point-table row order. Device traversal order
      is unspecified.

# 存储容量：设备数量由配置决定，每槽大小根据设备树总区域计算。
config DP_STORAGE_SLOT_COUNT
    int "Maximum number of persistent devices"
    default 6
    range 1 255
    help
      Divide the dp-params region into this many device NVS slots after
      reserving layout and management space. Each slot is rounded down to
      whole 4096-byte sectors and must contain at least two sectors.
      Changing this count changes the on-flash layout. A layout mismatch
      erases all DP parameters and reinitializes the region at startup.

config HEAP_MEM_POOL_ADD_SIZE_DATAPROCESS
    int "System heap budget for registered devices and point data (bytes)"
    default 4096
    range 256 65536
    help
      Each device registration allocates one private node with its point data.
      Include the node, point_count times sizeof(dp_point_data_t), and heap overhead.
      Persistent points also reserve a value_t snapshot in the same allocation.
      Snapshot pointers and validity flags are part of dp_point_data_t.
      Registration uses a temporary hashmap for duplicate keys. Include its
      bucket allocation and resize peak in addition to previously registered data.

# 保存线程：间隔是每轮保存结束后的等待时间。
config DP_SAVE_INTERVAL_MS
    int "Delay between parameter save passes (ms)"
    default 5000
    range 10 3600000

config DP_SAVE_STACK_SIZE
    int "Parameter save thread stack size"
    default 2048
    range 1024 16384

config DP_SAVE_PRIORITY
    int "Parameter save thread priority"
    default 10
    range 0 14

endif
```

## modules/dev/fan/Kconfig
```kconfig
config FAN
    bool "Fan PWM control and speed feedback"
    depends on PWM
    select PWM_CAPTURE
    help
      Instance-based PWM outputs and period feedback using the standard
      Zephyr PWM API. One shared input thread processes capture notifications.
      No shell, protocol or vendor registers.
```

## modules/dev/rs485/Kconfig
```kconfig
config RS485
    bool "RS485 byte I/O with software or hardware DE"
    depends on SERIAL && GPIO
    depends on UART_INTERRUPT_DRIVEN || UART_ASYNC_API
    select UART_USE_RUNTIME_CONFIGURE
    help
      Unified read/write access for GPIO-controlled or UART-controlled DE.
      No protocol events, timestamps or business threads. The asynchronous
      interface uses caller-owned UART receive buffers.

if RS485

choice RS485_BACKEND
    prompt "RS485 UART interface"
    default RS485_ASYNC if UART_ASYNC_API
    default RS485_INTERRUPT

config RS485_INTERRUPT
    bool "Interrupt-driven UART"
    depends on UART_INTERRUPT_DRIVEN

config RS485_ASYNC
    bool "Standard asynchronous UART"
    depends on UART_ASYNC_API
    help
      DMA belongs to the UART driver. Use caller-owned RX buffers and standard
      UART events. Synchronous write waits on the same asynchronous TX path;
      synchronous read polls UART only when asynchronous RX is inactive.

endchoice

endif
```

## modules/dev/tpc5120/Kconfig
```kconfig
config ADC_TPC5120
    bool "3PEAK TPC5120 SPI ADC"
    default y
    depends on ADC && SPI && DT_HAS_THREEPEAK_TPC5120_ENABLED
    help
      Synchronous 12-bit acquisition through the standard Zephyr ADC API.
      Supports all 16 single-ended channels and external reference ranges
      of 0 to VREF or 0 to 2 x VREF. No dedicated thread or heap allocation.

config ADC_TPC5120_INIT_PRIORITY
    int "TPC5120 initialization priority"
    default 80
    depends on ADC_TPC5120
    help
      Must be greater than SPI_INIT_PRIORITY.
```

## modules/dev/tpc5120/dts/bindings/adc/threepeak,tpc5120.yaml
```yaml
description: |
  3PEAK TPC5120 16-channel 12-bit SAR ADC with an external reference.
  Uses SPI mode 0, MSB first. Each conversion requires a separate
  16-clock CS frame. Channel results follow commands by two frames.
  Channel gain ADC_GAIN_1 selects 0..VREF; ADC_GAIN_1_2 selects 0..2*VREF.
  Only ADC_REF_EXTERNAL0 and ADC_ACQ_TIME_DEFAULT are supported.
  https://static.3peak.com/res/doc/ds/Datasheet_TPC512x.pdf

compatible: "threepeak,tpc5120"

include: [adc-controller.yaml, spi-device.yaml]

properties:
  spi-max-frequency:
    description: SPI clock frequency in Hz, not greater than 20000000.
  "#io-channel-cells":
    const: 1

io-channel-cells:
  - input
```

## modules/func/modbus/Kconfig
```kconfig
# 完整 ADU 路由可接收旧协议长帧；标准功能码仍由官方服务端检查数量。
config MODBUS_BUFFER_SIZE
    range 64 1100 if MODBUS_SUPPORT_SERVER

config MODBUS_SUPPORT
    bool "Zephyr Modbus shared transport support"
    depends on MODBUS
    help
      Shared RTU conversion and reviewed build-local Zephyr Modbus fixes.
      Does not create workers or register application routing.

config MODBUS_SUPPORT_SERVER_HOOKS
    bool
    depends on MODBUS_SUPPORT
    help
      Internal contract selected by the synchronous RAW server adapter.
      Other interfaces retain Zephyr work submission and ordinary handling.

config MODBUS_SUPPORT_SERVER
    bool "Synchronous Zephyr RAW server adapter"
    depends on MODBUS_SUPPORT && MODBUS_SERVER && !MODBUS_FP_EXTENSIONS
    select MODBUS_RAW_ADU
    select MODBUS_SUPPORT_SERVER_HOOKS
    help
      Keep official function-code parsing and formatting, with a synchronous
      application-thread adapter and one whole-request access callback.

config MODBUS_NUMOF_RAW_ADU
    depends on MODBUS_RAW_ADU
    default 4 if MODBUS_SUPPORT_SERVER
```

## modules/func/transmit/Kconfig
```kconfig
config TRANSMIT
    bool "Table-driven slave protocol forwarding"
    depends on MODBUS && MODBUS_SERVER && !MODBUS_FP_EXTENSIONS
    select DATAPROCESS
    select VPORT
    select MODBUS_SUPPORT
    select MODBUS_SUPPORT_SERVER
    help
      Shared protocol service with fixed per-session buffers and serialized execution.
      Application threads supply byte events, receive timing and sending.

config HEAP_MEM_POOL_ADD_SIZE_TRANSMIT
    int "System heap budget for forwarding engines and sessions"
    depends on TRANSMIT
    default 8192
    range 1024 131072
```

## modules/modbus/Kconfig
```kconfig
config MODBUS_SUPPORT
    bool "Zephyr Modbus shared transport support"
    depends on MODBUS
    help
      Shared RTU conversion and reviewed build-local Zephyr Modbus fixes.
      Does not create workers or register application routing.

config MODBUS_SUPPORT_SERVER_HOOKS
    bool
    depends on MODBUS_SUPPORT
    help
      Internal contract selected by the synchronous RAW server adapter.
      Other interfaces retain Zephyr work submission and ordinary handling.

config MODBUS_SUPPORT_SERVER
    bool "Synchronous Zephyr RAW server adapter"
    depends on MODBUS_SUPPORT && MODBUS_SERVER && !MODBUS_FP_EXTENSIONS
    select MODBUS_RAW_ADU
    select MODBUS_SUPPORT_SERVER_HOOKS
    help
      Keep official function-code parsing and formatting, with a synchronous
      application-thread adapter and one whole-request access callback.

config MODBUS_NUMOF_RAW_ADU
    depends on MODBUS_RAW_ADU
    default 4 if MODBUS_SUPPORT_SERVER
```

## modules/platform/gd32e505/Kconfig
```kconfig
config PWM_CAPTURE_GD32
    bool "GD32 standard PWM period capture API"
    default y
    depends on PWM && SOC_GD32E505 && DT_HAS_GD_GD32_PWM_CAPTURE_ENABLED
    select PWM_CAPTURE
    select PINCTRL
    select RESET
    help
      Dedicated 16-bit or 32-bit timer capture device. Implements standard
      PWM period capture on a selected channel in single or continuous mode.
      Pulse width capture and PWM output are unsupported on this device.

config PWM_CAPTURE_GD32_DIAGNOSTICS
    bool "GD32 capture timeout register diagnostics"
    depends on PWM_CAPTURE_GD32 && LOG
    help
      Log timer, clock, pin routing and interrupt state when stopping an
      unfinished capture from thread context. Intended for board bring-up.

config ADC_GD32E50X
    bool "GD32E50x synchronous ADC driver"
    default y
    depends on ADC && SOC_GD32E505
    depends on DT_HAS_GD_GD32E50X_ADC_ENABLED
    select PINCTRL
    select RESET
    select USE_GD32_ADC
    help
      Bounded polling driver for ADC0 external channels. Supports single-channel
      synchronous reads, 6/8/10/12-bit resolution and explicit calibration.
      DMA, asynchronous reads, sequence options and oversampling are unsupported.

config UART_GD32_ASYNC
    bool "GD32 UART standard asynchronous API"
    default y if UART_ASYNC_API
    depends on SOC_GD32E505 && USART_GD32 && DMA_GD32 && UART_ASYNC_API
    select UART_INTERRUPT_DRIVEN
    help
      Platform extension of the upstream GD32 UART driver with DMA TX.
      DMA RX uses hardware receiver timeout and caller-owned double buffers.
      UART instances without RX DMA retain interrupt-based async reception.

# 按硬件能力声明；不能依赖 DMA 开关，否则与其他驱动的 select DMA 形成环。
config SERIAL_SUPPORT_ASYNC
    default y if SOC_GD32E505 && USART_GD32 && DT_HAS_GD_GD32_DMA_ENABLED
```

## modules/platform/gd32e505/dts/bindings/pwm/gd,gd32-pwm-capture.yaml
```yaml
description: GD32 dedicated timer period capture through the standard PWM API
compatible: "gd,gd32-pwm-capture"
include: [base.yaml, pwm-controller.yaml, pinctrl-device.yaml]
properties:
  capture-channel:
    type: int
    default: 0
    enum: [0, 1, 2, 3]
    description: Physical timer channel owned by this capture device.
  capture-prescaler:
    type: int
    default: 1
    enum: [1, 2, 4, 8]
    description: Capture once every N edges; reported period remains one input period.
  pinctrl-0:
    required: true
  pinctrl-names:
    required: true
  "#pwm-cells":
    const: 3
pwm-cells:
  - channel
  - period
  - flags
```

## modules/transmit/Kconfig
```kconfig
config TRANSMIT
    bool "Table-driven slave protocol forwarding"
    depends on MODBUS && MODBUS_SERVER && !MODBUS_FP_EXTENSIONS
    select DATAPROCESS
    select VPORT
    select MODBUS_SUPPORT
    select MODBUS_SUPPORT_SERVER
    help
      Fixed per-instance buffers and synchronous protocol execution.
      Application threads supply byte events, receive timing and sending.

config HEAP_MEM_POOL_ADD_SIZE_TRANSMIT
    int "System heap budget for forwarding instances"
    depends on TRANSMIT
    default 8192
    range 1024 131072
```

## tests/dp_storage/testcase.yaml
```yaml
tests:
  idu.dp_storage:
    platform_allow:
      - native_sim/native/64
    tags:
      - nvs
      - dataprocess
```
